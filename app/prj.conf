## CMakeLists.txt
```
# SPDX-License-Identifier: CC0-1.0
cmake_minimum_required(VERSION 3.13.1)
find_package(Zephyr REQUIRED HINTS $ENV{ZEPHYR_BASE})

project(app LANGUAGES C)

target_sources(app PRIVATE 
  src/main.c
  src/canceler.c
  src/comm.c
  src/comm_transport.c
  src/gcode.c
  src/gcode_base.c
  src/slice.c
  src/settings.c
  src/motion.c
  src/motion_base.c
  src/motor.c
  src/pulser.c
  src/pump.c
  src/toolsupply.c
  src/wirefeed.c
  src/coords.c
)

# Include driver (headers & build)
target_include_directories(app PRIVATE ../include)
add_subdirectory(../drivers drivers)
```

## Kconfig
```
# SPDX-License-Identifier: CC0-1.0
menu "Zephyr"
source "Kconfig.zephyr"
endmenu

# EDM discharge module selection
choice EDM_MODULE
  prompt "EDM discharge module"
  default EDM_PULSER

config EDM_PULSER
  bool "Pulser board (I2C)"

config EDM_POWERCORE
  bool "Powercore module (EN + PWM feedback)"

endchoice

# Include spark drivers
rsource "../drivers/Kconfig"

module = APP
module-str = APP
source "subsys/logging/Kconfig.template.log_config"
```

## prj.conf
```kconfig
# SPDX-License-Identifier: CC0-1.0
# Basic kernel features
CONFIG_MAIN_STACK_SIZE=8192
CONFIG_FPU=y
CONFIG_FPU_SHARING=y
CONFIG_POLL=y
CONFIG_EVENTS=y
CONFIG_COUNTER=y
CONFIG_PWM=y

# Console
CONFIG_CONSOLE_SUBSYS=y
CONFIG_CONSOLE=y
CONFIG_UART_INTERRUPT_DRIVEN=y
CONFIG_UART_CONSOLE=y
CONFIG_CBPRINTF_FP_SUPPORT=y

# Debugging
CONFIG_DEBUG=y
CONFIG_DEBUG_INFO=y
CONFIG_DEBUG_OPTIMIZATIONS=y

# Compiler warnings as errors
CONFIG_COMPILER_WARNINGS_AS_ERRORS=y

# Allow unused const variables (disable specific warning)
CONFIG_COMPILER_OPT="-Wno-unused-const-variable"

# Disable boot banner
CONFIG_BOOT_BANNER=n
```

## powercore.conf
```kconfig
CONFIG_EDM_POWERCORE=y
```

## powercore.overlay
```dts
/* Powercore EDM module: disable I2C1 to free PB8/PB9 for GPIO use. */
&i2c1 {
	status = "disabled";
};
```

## src/main.c
```c
// SPDX-FileCopyrightText: 2025 夕月霞
// SPDX-License-Identifier: AGPL-3.0-or-later
/**
 * Application entry point for spark core firmware.
 * Main command loop is executed here.
 */
#include "canceler.h"
#include "comm.h"
#include "coords.h"
#include "gcode.h"
#include "motion.h"
#include "motor.h"
#include "pulser.h"
#include "pump.h"
#include "settings.h"
#include "slice.h"
#include "toolsupply.h"
#include "wirefeed.h"

#include <stdlib.h>
#include <string.h>
#include <zephyr/kernel.h>

static bool command_running = false;

// Command: gcode
static void cmd_gcode(slice_t full_command, slice_t maybe_next_command) {
  exec_gcode(full_command, maybe_next_command);
}

// Command: set <key> <value>
static void cmd_set(slice_t command, slice_t args) {
  if (sl_is_empty(args)) {
    comm_error(command, "missing args");
    return;
  }

  slice_t value;
  slice_t key = sl_split_by_spaces(args, &value);
  if (sl_is_empty(value)) {
    comm_error(command, "missing value");
    return;
  }

  // Parse and validate float value
  float float_value;
  if (!sl_parse_float(value, &float_value)) {
    comm_error(command, "invalid float value");
    return;
  }
  if (!settings_set(key, float_value)) {
    comm_error(command, "setting failed");
  }
}

// Command: get
static void cmd_get(slice_t command, slice_t args) {
  if (!sl_is_empty(args)) {
    comm_error(command, "extra args");
    return;
  }

  // List all settings
  const char* key;
  float value;
  comm_ps_begin(PS_SETTINGS);
  for (int i = 0; settings_get_by_index(i, &key, &value); i++) {
    comm_ps_k_vfloat(PS_SETTINGS, key, value);
  }
  comm_ps_end(PS_SETTINGS);
}

// Command: stat
static void cmd_stat(slice_t command, slice_t args) {
  if (!sl_is_empty(args)) {
    comm_error(command, "extra args");
    return;
  }

  comm_ps_begin(PS_STAT);
  motor_dump_status();
  if (canceler_cancel_needed()) {
    return;
  }
  pulser_dump_status();
  if (canceler_cancel_needed()) {
    return;
  }
  wirefeed_dump_status();
  if (canceler_cancel_needed()) {
    return;
  }
  motion_dump_status();
  comm_ps_end(PS_STAT);
}

static bool is_gcode(slice_t command) {
  return command.size > 0 && (command.ptr[0] == 'G' || command.ptr[0] == 'M');
}

/**
 * @param next_command empty if not available.
 */
static void handle_command(slice_t command, slice_t next_command) {
  // G-code or command?
  if (is_gcode(command)) {
    bool next_avail = !sl_is_empty(next_command) && is_gcode(next_command);
    cmd_gcode(command, next_avail ? next_command : sl_empty());
  } else {
    slice_t args;
    slice_t cmd = sl_split_by_spaces(command, &args);

    // Dispatch to command handler
    if (sl_eq_str(cmd, "stat")) {
      cmd_stat(command, args);
    } else if (sl_eq_str(cmd, "set")) {
      cmd_set(command, args);
    } else if (sl_eq_str(cmd, "get")) {
      cmd_get(command, args);
    } else {
      comm_error(command, "unknown command");
    }
  }
}

static void handle_signal(payload_t* payload) {
  slice_t signal = sl_from_buf(payload->data, payload->size);
  if (sl_eq_str(signal, "!")) {
    canceler_cancel();
  } else if (sl_eq_str(signal, "?pos")) {
    // Print ready with current position
    pos_phys_t machine_pos = motion_get_current_pos();

    // TODO: these are not thread-safe.
    coord_system_t current_cs = gcode_get_current_coord_system();
    const coord_offsets_t* offsets = gcode_get_coord_offsets();

    const char* cs_name = "";
    const char* prefix = "";
    switch (current_cs) {
      case COORD_SYSTEM_GRINDER:
        cs_name = "grinder";
        prefix = "g";
        break;
      case COORD_SYSTEM_WORK:
        cs_name = "work";
        prefix = "w";
        break;
      case COORD_SYSTEM_TOOLSUPPLY:
        cs_name = "toolsupply";
        prefix = "t";
        break;
      case COORD_SYSTEM_MACHINE:
        cs_name = "machine";
        prefix = "m";
        break;
    }

    comm_ps_raw(PS_POS, "< sys:\"%s\" m.x:%.3f m.y:%.3f m.z:%.3f m.c:%.3f%s",
                cs_name, (double)machine_pos.x, (double)machine_pos.y,
                (double)machine_pos.z, (double)(machine_pos.c * 360.0f),
                (current_cs == COORD_SYSTEM_MACHINE ? " >" : ""));
    if (current_cs == COORD_SYSTEM_MACHINE) {
      return;
    }

    pos_phys_t cs_pos = coords_from_machine(&machine_pos, current_cs, offsets);
    comm_ps_raw(PS_POS, "%s.x:%.3f %s.y:%.3f %s.z:%.3f %s.c:%.3f >", prefix,
                (double)cs_pos.x, prefix, (double)cs_pos.y, prefix,
                (double)cs_pos.z, prefix, (double)(cs_pos.c * 360.0f));
  } else if (sl_eq_str(signal, "?queue")) {
    int cap;
    int used;
    comm_stat_command_queue(&cap, &used);
    int num_executing = command_running ? 1 : 0;
    comm_ps_raw(PS_QUEUE, "< cap:%d num:%d >", cap, used + num_executing);
  } else if (sl_eq_str(signal, "?edm")) {
    ps_edm_t edm = motion_get_edm_state();
    comm_ps_begin(PS_EDM);
    if (edm.has_edm_data) {
      comm_ps_raw(PS_EDM, "eff_duty:%.3f open:%.1f short:%.1f temp:%d",
                  (double)edm.eff_duty, (double)edm.r_open, (double)edm.r_short,
                  (int)(edm.temp));
    }
    if (edm.is_moving) {
      comm_ps_raw(PS_EDM, "pb_f:%.3f pb_b:%.3f dist:%.3f dist_max:%.3f",
                  (double)edm.pb_front, (double)edm.pb_back,
                  (double)edm.distance, (double)edm.distance_max);
    }
    comm_ps_end(PS_EDM);
  } else {
    // Unknown signal. Probably better to ignore, to not clog stream.
  }
}

int main() {
  k_float_enable(k_work_queue_thread_get(&k_sys_work_q), K_FP_REGS);
  k_float_enable(k_current_get(), K_FP_REGS);

  // init core
  canceler_init();
  comm_init(handle_signal);

  comm_ps_begin(PS_INIT);

  // init hardware
  bool ok = true;
  ok &= motor_init();
  ok &= pulser_init();
  ok &= toolsupply_init();
  ok &= pump_init();
  if (!ok) {
    // cannot proceed to module init if hardware is failing
    comm_ps_k_vbool(PS_INIT, "ok", false);
    comm_ps_end(PS_INIT);
    return 1;
  }

  // init modules
  ok &= motion_init();
  ok &= wirefeed_init();
  if (!ok) {
    comm_ps_k_vbool(PS_INIT, "ok", false);
    comm_ps_end(PS_INIT);
    return 1;
  }

  // apply default settings
  ok &= settings_apply_all();

  comm_ps_k_vbool(PS_INIT, "ok", ok);
  comm_ps_end(PS_INIT);

  while (true) {
    // Ignore commands during cancelation window.
    while (canceler_cancel_needed()) {
      comm_clear_commands();
      k_sleep(K_MSEC(50));
    }

    comm_wait_for_command();

    // Long enough for queue to accumulate,
    // but short enough for user to feel responsive.
    k_sleep(K_MSEC(100));

    // Keep executing without wait until queue is fully consumed.
    while (!canceler_cancel_needed()) {
      payload_t cmd;
      payload_t next_cmd;
      int num_avail = comm_get_command_if_avail(&cmd, &next_cmd);
      if (num_avail == 0) {
        // comm_clear_commands() was called or queue exhausted
        break;
      }
      command_running = true;
      handle_command(sl_from_buf(cmd.data, cmd.size),
                     num_avail >= 2 ? sl_from_buf(next_cmd.data, next_cmd.size)
                                    : sl_empty());
      command_running = false;
    }
  }

  return 0;
}
```

## src/canceler.c
```c
// SPDX-FileCopyrightText: 2025 夕月霞
// SPDX-License-Identifier: AGPL-3.0-or-later
#include "canceler.h"

#include <zephyr/kernel.h>

static struct k_timer cancel_timer;
static bool cancel_needed = false;

// (ISR) Handler to end cancelation window
static void on_cancel_end(struct k_timer* timer) {
  cancel_needed = false;
}

void canceler_init() {
  k_timer_init(&cancel_timer, &on_cancel_end, NULL);
  cancel_needed = false;
}

void canceler_cancel() {
  cancel_needed = true;
  k_timer_start(&cancel_timer, CANCEL_TIMEOUT, K_FOREVER);
}

bool canceler_cancel_needed() {
  return cancel_needed;
}
```

## src/canceler.h
```c
// SPDX-FileCopyrightText: 2025 夕月霞
// SPDX-License-Identifier: AGPL-3.0-or-later
/**
 * (Singleton) State machine whose whole purpose is to control entire app's
 * cancellation.
 */
#pragma once

#include <stdbool.h>

// Cancel is active for CANCEL_TIMEOUT, then reset to normal automatically,
// after canceler_cancel() is called. All modules must poll
// canceler_cancel_needed() frequently enough to be able to cancel their
// operation within this window.
#define CANCEL_TIMEOUT K_MSEC(500)

/**
 * (blocking) Initialize canceler module.
 */
void canceler_init();

/**
 * Invoke cancellation.
 */
void canceler_cancel();

/**
 * Returns true if caller should cancel current operation.
 */
bool canceler_cancel_needed();
```

## src/comm.c
```c
// SPDX-FileCopyrightText: 2025 夕月霞
// SPDX-License-Identifier: AGPL-3.0-or-later
#include "comm.h"

#include "comm_transport.h"

#include <stdarg.h>
#include <stdio.h>
#include <string.h>
#include <zephyr/kernel.h>

////////////////////
// RX (down): commands (signals are immediately handled)

// big enough to hold 5 sec of commands
// 100 byte line takes 10ms at 100kbaud/s.
// NOTE: command that instantly finishes always starves the queue, though. it's
// up to the host to make commands "big" enough.
#define COMMAND_QUEUE_CAPACITY 500

K_MSGQ_DEFINE(cmd_msgq, sizeof(payload_t), COMMAND_QUEUE_CAPACITY, 1);

////////////////////
// TX (up): p-states (high & normal priority)

// chosen to not block any typical write burst, esp errors.
#define TX_QUEUE_PRIO_CAPACITY 25
#define TX_QUEUE_CAPACITY 100

K_MSGQ_DEFINE(tx_msgq_prio, sizeof(payload_t), TX_QUEUE_PRIO_CAPACITY, 1);
K_MSGQ_DEFINE(tx_msgq, sizeof(payload_t), TX_QUEUE_CAPACITY, 1);

static bool payload_is_signal(const payload_t* payload) {
  if (payload->size == 0) {
    return false;
  }
  char first_char = payload->data[0];
  return first_char == '!' || first_char == '?';
}

static void comm_thread(void* p1, void* p2, void* p3) {
  payload_handler_t on_signal = (payload_handler_t)p1;

  struct k_poll_event events[3];
  const int EV_IX_TX_PRIO = 0;
  const int EV_IX_TX = 1;
  const int EV_IX_RX = 2;
  k_poll_event_init(&events[EV_IX_TX_PRIO], K_POLL_TYPE_MSGQ_DATA_AVAILABLE,
                    K_POLL_MODE_NOTIFY_ONLY, &tx_msgq_prio);
  k_poll_event_init(&events[EV_IX_TX], K_POLL_TYPE_MSGQ_DATA_AVAILABLE,
                    K_POLL_MODE_NOTIFY_ONLY, &tx_msgq);
  tran_poll_event_get(&events[EV_IX_RX]);

  while (true) {
    if (k_poll(events, ARRAY_SIZE(events), K_FOREVER) != 0) {
      // (shouldn't happen) err on the side of communication.
      continue;
    }

    // Events matter in this order.
    // 1. TX_PRIO might contain critical error/debug information
    // 2. RX might contain cancel signal which nullifies further TX.
    // 3. TX is most likely to get stuck with infinite data bug.

    if (events[EV_IX_TX_PRIO].state == K_POLL_STATE_MSGQ_DATA_AVAILABLE) {
      payload_t payload;
      k_msgq_get(&tx_msgq_prio, &payload, K_NO_WAIT);
      tran_put_payload(&payload);

      events[EV_IX_TX_PRIO].state = K_POLL_STATE_NOT_READY;
    } else if (events[EV_IX_RX].state == K_POLL_STATE_MSGQ_DATA_AVAILABLE) {
      payload_t payload;
      tran_get_payload(&payload, K_NO_WAIT);

      if (payload_is_signal(&payload)) {
        on_signal(&payload);
      } else {
        k_msgq_put(&cmd_msgq, &payload, K_FOREVER);
      }

      events[EV_IX_RX].state = K_POLL_STATE_NOT_READY;
    } else if (events[EV_IX_TX].state == K_POLL_STATE_MSGQ_DATA_AVAILABLE) {
      payload_t payload;
      k_msgq_get(&tx_msgq, &payload, K_NO_WAIT);
      tran_put_payload(&payload);

      events[EV_IX_TX].state = K_POLL_STATE_NOT_READY;
    }
  }
}

K_THREAD_STACK_DEFINE(comm_stack_area, 1024);
struct k_thread comm_thread_data;

void comm_init(payload_handler_t on_signal) {
  if (!tran_init()) {
    // can't do any reporting
    return;
  }

  // Create prio 0 (preemptible, same as main) thread.
  k_thread_create(&comm_thread_data, comm_stack_area,
                  K_THREAD_STACK_SIZEOF(comm_stack_area), comm_thread,
                  (void*)on_signal, NULL, NULL, 0, K_FP_REGS, K_NO_WAIT);
}

static int copy_str(uint8_t* buf, const char* str) {
  int len = strlen(str);
  memcpy(buf, str, len);
  return len;
}

static int copy_ps_tag(ps_type_t ps, uint8_t* buf) {
  const char* tag = "";  // not used, but to suppress warning
  switch (ps) {
    case PS_ERROR:
      tag = "error ";
      break;
    case PS_POS:
      tag = "pos ";
      break;
    case PS_QUEUE:
      tag = "queue ";
      break;
    case PS_EDM:
      tag = "edm ";
      break;
    case PS_INIT:
      tag = "init ";
      break;
    case PS_SETTINGS:
      tag = "stg ";
      break;
    case PS_STAT:
      tag = "stat ";
      break;
  }
  return copy_str(buf, tag);
}

static void put_payload(const uint8_t* ptr, int size, ps_type_t ps) {
  payload_t payload;
  payload.size = size;
  memcpy(payload.data, ptr, size);

  bool high_prio = (ps == PS_ERROR);
  if (high_prio) {
    k_msgq_put(&tx_msgq_prio, &payload, K_FOREVER);
  } else {
    k_msgq_put(&tx_msgq, &payload, K_FOREVER);
  }
}

void comm_ps_raw(ps_type_t ps, const char* fmt, ...) {
  uint8_t buffer[PAYLOAD_BUFFER_SIZE];
  int offset = copy_ps_tag(ps, buffer);

  va_list args;
  va_start(args, fmt);
  offset += vsnprintf(buffer + offset, sizeof(buffer) - offset, fmt, args);
  va_end(args);

  put_payload(buffer, offset, ps);
}

void comm_ps_begin(ps_type_t ps) {
  uint8_t buffer[PAYLOAD_BUFFER_SIZE];
  int offset = copy_ps_tag(ps, buffer);

  buffer[offset] = '<';
  offset++;

  put_payload(buffer, offset, ps);
}

void comm_ps_k_vfmtstr(ps_type_t ps, const char* key, const char* fmt, ...) {
  uint8_t buffer[PAYLOAD_BUFFER_SIZE];
  int offset = copy_ps_tag(ps, buffer);

  offset += copy_str(buffer + offset, key);
  offset += copy_str(buffer + offset, ":\"");

  // value
  // TODO: escape
  va_list args;
  va_start(args, fmt);
  offset += vsnprintf(buffer + offset, sizeof(buffer) - offset, fmt, args);
  va_end(args);

  offset += copy_str(buffer + offset, "\"");

  put_payload(buffer, offset, ps);
}

void comm_ps_k_v32hex(ps_type_t ps, const char* key, uint32_t value) {
  uint8_t buffer[PAYLOAD_BUFFER_SIZE];
  int offset = copy_ps_tag(ps, buffer);

  offset += copy_str(buffer + offset, key);
  offset += copy_str(buffer + offset, ":");
  offset += snprintf(buffer + offset, sizeof(buffer) - offset, "0x%08x", value);

  put_payload(buffer, offset, ps);
}

void comm_ps_k_vfloat(ps_type_t ps, const char* key, float value) {
  uint8_t buffer[PAYLOAD_BUFFER_SIZE];
  int offset = copy_ps_tag(ps, buffer);

  offset += copy_str(buffer + offset, key);
  offset += copy_str(buffer + offset, ":");
  offset +=
      snprintf(buffer + offset, sizeof(buffer) - offset, "%g", (double)value);

  put_payload(buffer, offset, ps);
}

void comm_ps_k_vint(ps_type_t ps, const char* key, int value) {
  uint8_t buffer[PAYLOAD_BUFFER_SIZE];
  int offset = copy_ps_tag(ps, buffer);

  offset += copy_str(buffer + offset, key);
  offset += copy_str(buffer + offset, ":");
  offset += snprintf(buffer + offset, sizeof(buffer) - offset, "%d", value);

  put_payload(buffer, offset, ps);
}

void comm_ps_k_vbool(ps_type_t ps, const char* key, bool value) {
  uint8_t buffer[PAYLOAD_BUFFER_SIZE];
  int offset = copy_ps_tag(ps, buffer);

  offset += copy_str(buffer + offset, key);
  offset += copy_str(buffer + offset, ":");
  offset += copy_str(buffer + offset, value ? "true" : "false");

  put_payload(buffer, offset, ps);
}

void comm_ps_end(ps_type_t ps) {
  uint8_t buffer[PAYLOAD_BUFFER_SIZE];
  int offset = copy_ps_tag(ps, buffer);

  buffer[offset] = '>';
  offset++;

  put_payload(buffer, offset, ps);
}

void comm_error(slice_t source, const char* fmt, ...) {
  uint8_t buffer[PAYLOAD_BUFFER_SIZE];
  int offset = copy_ps_tag(PS_ERROR, buffer);

  offset += copy_str(buffer + offset, "<");

  if (!sl_is_empty(source)) {
    source = sl_sub(source, 0, 50);  // limit size
    offset += copy_str(buffer + offset, " src:");
    offset += copy_str(buffer + offset, "\"");
    memcpy(buffer + offset, source.ptr,
           source.size);  // TODO: size check & escape
    offset += source.size;
    offset += copy_str(buffer + offset, "\"");
  }

  // msg
  offset += copy_str(buffer + offset, " msg:");
  offset += copy_str(buffer + offset, "\"");
  // TODO: escape
  va_list args;
  va_start(args, fmt);
  offset += vsnprintf(buffer + offset, sizeof(buffer) - offset, fmt, args);
  va_end(args);

  offset += copy_str(buffer + offset, "\"");

  offset += copy_str(buffer + offset, " >");
  put_payload(buffer, offset, PS_ERROR);
}

/**
 * (blocking) Wait until a command become available.
 */
void comm_wait_for_command() {
  struct k_poll_event event;
  k_poll_event_init(&event, K_POLL_TYPE_MSGQ_DATA_AVAILABLE,
                    K_POLL_MODE_NOTIFY_ONLY, &cmd_msgq);
  k_poll(&event, 1, K_FOREVER);
}

void comm_clear_commands() {
  k_msgq_purge(&cmd_msgq);
}

/**
 * Get 1 command and peek next command, immediately.
 * Data will be copied to cmd, next_cmd.
 *
 * @returns number of available commands (0, 1, 2).
 */
int comm_get_command_if_avail(payload_t* cmd, payload_t* next_cmd) {
  int num;
  k_sched_lock();
  int num_in_q = k_msgq_num_used_get(&cmd_msgq);
  if (num_in_q >= 2) {
    num = 2;
    k_msgq_peek_at(&cmd_msgq, next_cmd, 1);
    k_msgq_get(&cmd_msgq, cmd, K_NO_WAIT);
  } else if (num_in_q == 1) {
    num = 1;
    k_msgq_get(&cmd_msgq, cmd, K_NO_WAIT);
  } else {
    num = 0;
  }
  k_sched_unlock();
  return num;
}

void comm_stat_command_queue(int* num_cap, int* num_used) {
  if (num_cap) {
    *num_cap = COMMAND_QUEUE_CAPACITY;
  }
  if (num_used) {
    *num_used = k_msgq_num_used_get(&cmd_msgq);
  }
}
```

## src/comm.h
```c
// SPDX-FileCopyrightText: 2025 夕月霞
// SPDX-License-Identifier: AGPL-3.0-or-later
/**
 * (Singleton) Semi-structured serial printing functions for the app.
 * Don't use printk(), LOG_*() etc. which will break the protocol.
 *
 * See spec/protocol.md for details.
 */
#pragma once

#include "comm_transport.h"
#include "slice.h"

#include <stdbool.h>
#include <stdint.h>

// Handles borrowed const payload.
typedef void (*payload_handler_t)(payload_t* payload);

/**
 * (blocking) Initialize communication subsystem.
 * Internally spawns long-running thread dedicated to communication.
 *
 * @param on_signal signal handler. Called from communication thread. Must
 * finish within 10ms. (faster is better)
 */
void comm_init(payload_handler_t on_signal);

// P-state types.
// PS_ERROR is special, as it's sent in high-priority queue.
typedef enum {
  PS_ERROR,
  PS_QUEUE,
  PS_POS,
  PS_EDM,
  PS_INIT,
  PS_SETTINGS,
  PS_STAT,
} ps_type_t;

/**
 * (blocking) Wait until a command become available.
 */
void comm_wait_for_command();

/**
 * Get 1 command and peek next command, immediately.
 * Data will be copied to cmd, next_cmd.
 *
 * @returns number of available commands (0, 1, 2).
 */
int comm_get_command_if_avail(payload_t* cmd, payload_t* next_cmd);

/**
 * Clears command buffer.
 * OK to call from different thread simultaneously while comm_wait_for_command()
 * or comm_get_command_if_avail() is running.
 */
void comm_clear_commands();

/**
 * Fetches current command queue statistics.
 * @param num_cap (optional) capacity of command queue will be stored.
 * @param num_used (optional) number of used slots in command queue will be
 * stored.
 */
void comm_stat_command_queue(int* num_cap, int* num_used);

/**
 * Print entire p-state.
 * e.g. fmt=="< x:%f y:%f >"
 * Caller must guarantee entire thing (including tag for ps) fits in
 * PAYLOAD_BUFFER_SIZE.
 */
void comm_ps_raw(ps_type_t ps, const char* fmt, ...);

/** Get new partial state context. */
void comm_ps_begin(ps_type_t ps);

/** Add string value. */
void comm_ps_k_vfmtstr(ps_type_t ps, const char* key, const char* fmt, ...);

/** Add hex value. */
void comm_ps_k_v32hex(ps_type_t ps, const char* key, uint32_t value);

/** Add float value. */
void comm_ps_k_vfloat(ps_type_t ps, const char* key, float value);

/** Add int value. */
void comm_ps_k_vint(ps_type_t ps, const char* key, int value);

/** Add boolean value. */
void comm_ps_k_vbool(ps_type_t ps, const char* key, bool value);

/** Finish the partial state. */
void comm_ps_end(ps_type_t ps);

/** Print error message. */
void comm_error(slice_t source, const char* fmt, ...);

/** Assert that cond is true, and print error otherwise. Non-blocking unless too
 * many errors occur at once. */
#define comm_assert(cond)                                                    \
  {                                                                          \
    if (!(cond)) {                                                           \
      char* fname = strrchr(__FILE__, '/');                                  \
      fname = fname == NULL ? __FILE__ : (fname + 1);                        \
      comm_ps_raw(PS_ERROR, "< msg:\"assert failed\" file:\"%s\" line:%d >", \
                  fname, __LINE__);                                          \
    }                                                                        \
  }
```

## src/comm_raw.c
```c
// SPDX-FileCopyrightText: 2025 夕月霞
// SPDX-License-Identifier: AGPL-3.0-or-later
#include "comm_raw.h"

#include <stdarg.h>
#include <stdio.h>
#include <zephyr/device.h>
#include <zephyr/devicetree.h>
#include <zephyr/drivers/uart.h>

// Global console UART device
static const struct device* console_uart_dev =
    DEVICE_DT_GET(DT_CHOSEN(zephyr_console));

void comm_raw_init() {
  if (!device_is_ready(console_uart_dev)) {
    // not ready, but no way to tell user.
  }
}

void comm_raw_putc(char c) {
  if (c == '\n') {
    uart_poll_out(console_uart_dev, '\r');
  }
  uart_poll_out(console_uart_dev, c);
}

void comm_raw_puts(const char* str) {
  while (*str) {
    comm_raw_putc(*str++);
  }
}

void comm_raw_printf(const char* fmt, ...) {
  va_list args;
  va_start(args, fmt);
  comm_raw_vprintf(fmt, args);
  va_end(args);
}

void comm_raw_vprintf(const char* fmt, va_list args) {
  char buffer[256];
  vsnprintf(buffer, sizeof(buffer), fmt, args);
  comm_raw_puts(buffer);
}

int comm_raw_poll_in(unsigned char* ch) {
  return uart_poll_in(console_uart_dev, ch);
}
```

## src/comm_raw.h
```c
// SPDX-FileCopyrightText: 2025 夕月霞
// SPDX-License-Identifier: AGPL-3.0-or-later
/**
 * (Singleton) Raw serial communcation.
 * 99% of the app code should use comm.h instead.
 * We need this (instead of using CONSOLE functionality),
 * because we wanted to disable console echo.
 */
#pragma once

#include <stdarg.h>

void comm_raw_init();
void comm_raw_putc(char c);
void comm_raw_puts(const char* str);
void comm_raw_printf(const char* fmt, ...);
void comm_raw_vprintf(const char* fmt, va_list args);
int comm_raw_poll_in(unsigned char* ch);
```

## src/comm_transport.c
```c
// SPDX-FileCopyrightText: 2025 夕月霞
// SPDX-License-Identifier: AGPL-3.0-or-later
#include "comm_transport.h"

#include <stdarg.h>
#include <stdio.h>
#include <string.h>
#include <zephyr/device.h>
#include <zephyr/devicetree.h>
#include <zephyr/drivers/uart.h>
#include <zephyr/kernel.h>

static const struct device* uart_dev = DEVICE_DT_GET(DT_CHOSEN(zephyr_console));

// Maximum valid line size allowed by the protocol.
// payload + 1 (seq) + 4 (hash) + 1 (newline)
#define LINE_BUFFER_SIZE (PAYLOAD_BUFFER_SIZE + 6)

typedef struct {
  int size;
  uint8_t data[LINE_BUFFER_SIZE];
} line_buf_t;

////////////////////
// Control
static bool mode_interactive = true;

////////////////////
// RX (down)

// 2 should be enough.
// worst case: min valid payload (2 byte -> 20us at 100kbaud/s) coming in.
// Caller has (RX_QUEUE_CAPACITY - 1) x 20us time to consume the queue.
#define RX_QUEUE_CAPACITY 2

// empty (size == 0) data not allowed in tran_rx_msgq
K_MSGQ_DEFINE(tran_rx_msgq, sizeof(payload_t), RX_QUEUE_CAPACITY, 1);
static payload_t rx_assembly;

////////////////////
// TX (up)

#define TX_QUEUE_CAPACITY 2

// empty (size == 0) data not allowed in tran_tx_msgq
K_MSGQ_DEFINE(tran_tx_msgq, sizeof(line_buf_t), TX_QUEUE_CAPACITY, 1);
static line_buf_t tx_sending_buf;
static int tx_sending_pos = -1;  // -1 if tx_sending_buf is of no use.

// cf. CRC for 100byte is 20~40us.
// 1 byte transmit is 100us. should not calculate CRC for entire thing in this
// ISR. incremental CRC will be totally ok.

// (ISR) Send string for echoing.
static void echo_if_should(const char* data) {
  if (tx_sending_pos >= 0 || k_msgq_num_used_get(&tran_tx_msgq) > 0) {
    // shouldn't echo if sending something
    return;
  }
  line_buf_t buf;
  buf.size = strlen(data);
  memcpy(buf.data, data, buf.size);
  k_msgq_put(&tran_tx_msgq, &buf, K_NO_WAIT);
}

// (ISR) UART interrupt handler
static void uart_isr(const struct device* dev, void* user_data) {
  uart_irq_update(dev);

  // RX
  if (uart_irq_rx_ready(dev)) {
    uint8_t c;
    while (uart_fifo_read(dev, &c, 1) == 1) {
      if (c == '\n') {
        // Newline: complete current buffer and notify
        if (mode_interactive) {
          echo_if_should("\r\n");
        }
        if (rx_assembly.size > 0) {
          k_msgq_put(&tran_rx_msgq, &rx_assembly, K_NO_WAIT);
          rx_assembly.size = 0;
        }
      } else if (c == '\b' || c == 0x7F) {
        // Backspace: pop last char & notify to handle backspace echo
        if (mode_interactive && rx_assembly.size > 0) {
          echo_if_should(" \b");
          rx_assembly.size--;
        }
      } else if (c >= 0x20 && c <= 0x7E) {
        // Valid line content
        if (rx_assembly.size < LINE_BUFFER_SIZE) {
          rx_assembly.data[rx_assembly.size] = c;
          rx_assembly.size++;
        }
      }
    }
  }

  // TX
  if (uart_irq_tx_ready(dev)) {
    if (tx_sending_pos < 0) {
      if (k_msgq_get(&tran_tx_msgq, &tx_sending_buf, K_NO_WAIT) == 0) {
        // start sending
        tx_sending_pos = 0;
      } else {
        // nothing to send
        uart_irq_tx_disable(dev);
        return;
      }
    }

    if (tx_sending_pos >= 0) {
      int to_send = tx_sending_buf.size - tx_sending_pos;
      int sent =
          uart_fifo_fill(dev, &tx_sending_buf.data[tx_sending_pos], to_send);
      tx_sending_pos += sent;
      if (tx_sending_pos >= tx_sending_buf.size) {
        tx_sending_pos = -1;
      }
    }
  }
}

bool tran_init() {
  if (!device_is_ready(uart_dev)) {
    // can't do any reporting
    return false;
  }

  // Configure UART interrupts
  uart_irq_callback_user_data_set(uart_dev, uart_isr, NULL);
  uart_irq_rx_enable(uart_dev);

  // send empty line to flush pre-init broken data (often bunch of zeros) on the
  // serial line.
  line_buf_t buf;
  buf.size = 1;
  buf.data[0] = '\n';
  k_msgq_put(&tran_tx_msgq, &buf, K_FOREVER);
  return true;
}

int tran_get_payload(payload_t* out, k_timeout_t timeout) {
  return k_msgq_get(&tran_rx_msgq, out, timeout);
}

void tran_poll_event_get(struct k_poll_event* event) {
  k_poll_event_init(event, K_POLL_TYPE_MSGQ_DATA_AVAILABLE,
                    K_POLL_MODE_NOTIFY_ONLY, &tran_rx_msgq);
}

void tran_put_payload(const payload_t* payload) {
  line_buf_t buf;
  buf.size = payload->size;
  memcpy(buf.data, payload->data, payload->size);
  buf.data[payload->size] = '\n';
  buf.size = payload->size + 1;

  uart_irq_tx_enable(uart_dev);
  k_msgq_put(&tran_tx_msgq, &buf, K_FOREVER);
}
```

## src/comm_transport.h
```c
// SPDX-FileCopyrightText: 2025 夕月霞
// SPDX-License-Identifier: AGPL-3.0-or-later
/**
 * (Singleton) Internal layer for comm module, handling transport layer of the
 * protocol.
 */
#pragma once

#include "slice.h"

#include <stdbool.h>
#include <stdint.h>
#include <zephyr/kernel.h>

// Maximum payload size defined by the protocol.
#define PAYLOAD_BUFFER_SIZE 100

typedef struct {
  int size;
  uint8_t data[PAYLOAD_BUFFER_SIZE];
} payload_t;

/**
 * Init transport layer.
 * @returns true on success.
 */
bool tran_init();

/**
 * Get received payload.
 * @param out output buffer. Guaranteed to have size > 0 on success.
 * @param timeout timeout
 * @returns 0 if data is copied to out. -ENOMSG if no message (when K_NO_WAIT).
 * -EAGAIN timed out.
 */
int tran_get_payload(payload_t* out, k_timeout_t timeout);

/**
 * Configures poll event for tran_get_payload() availability.
 */
void tran_poll_event_get(struct k_poll_event* event);

/**
 * Write data. Caller is free to reuse data for other purposes.
 * This function will block until transmit is complete and internal buffer is
 * ready.
 */
void tran_put_payload(const payload_t* payload);
```

## src/console_utils.c
```c
#include "console_utils.h"

#include <stdarg.h>
#include <stdio.h>
#include <zephyr/device.h>
#include <zephyr/devicetree.h>
#include <zephyr/drivers/uart.h>

// Global console UART device pointer
static const struct device* console_uart_dev;

void console_utils_init() {
  console_uart_dev = DEVICE_DT_GET(DT_CHOSEN(zephyr_console));
}

void console_putc(char c) {
  if (console_uart_dev && device_is_ready(console_uart_dev)) {
    if (c == '\n') {
      uart_poll_out(console_uart_dev, '\r');
    }
    uart_poll_out(console_uart_dev, c);
  }
}

void console_puts(const char* str) {
  while (*str) {
    console_putc(*str++);
  }
}

void console_printf(const char* fmt, ...) {
  char buffer[256];
  va_list args;

  va_start(args, fmt);
  vsnprintf(buffer, sizeof(buffer), fmt, args);
  va_end(args);

  console_puts(buffer);
}
```

## src/console_utils.h
```c
#pragma once

void console_putc(char c);
void console_puts(const char* str);
void console_printf(const char* fmt, ...);
void console_utils_init();
```

## src/coords.c
```c
// SPDX-FileCopyrightText: 2025 夕月霞
// SPDX-License-Identifier: AGPL-3.0-or-later
#include "coords.h"

#include <math.h>

static void add_offset_xyz(pos_phys_t* dst, const pos_phys_t* offset) {
  dst->x += offset->x;
  dst->y += offset->y;
  dst->z += offset->z;
}

static void sub_offset_xyz(pos_phys_t* dst, const pos_phys_t* offset) {
  dst->x -= offset->x;
  dst->y -= offset->y;
  dst->z -= offset->z;
}

pos_phys_t coords_to_machine(const pos_phys_t* pos,
                             coord_system_t from_cs,
                             const coord_offsets_t* offsets) {
  pos_phys_t result = *pos;

  switch (from_cs) {
    case COORD_SYSTEM_MACHINE:
      // no conversion needed
      break;
    case COORD_SYSTEM_GRINDER:
      add_offset_xyz(&result, &offsets->grinder_origin);
      break;
    case COORD_SYSTEM_WORK:
      add_offset_xyz(&result, &offsets->work_origin);
      break;
    case COORD_SYSTEM_TOOLSUPPLY:
      add_offset_xyz(&result, &offsets->toolsupply_origin);
      break;
  }

  return result;
}

pos_phys_t coords_from_machine(const pos_phys_t* machine_pos,
                               coord_system_t to_cs,
                               const coord_offsets_t* offsets) {
  pos_phys_t result = *machine_pos;

  switch (to_cs) {
    case COORD_SYSTEM_MACHINE:
      // no conversion needed
      break;
    case COORD_SYSTEM_GRINDER:
      sub_offset_xyz(&result, &offsets->grinder_origin);
      break;
    case COORD_SYSTEM_WORK:
      sub_offset_xyz(&result, &offsets->work_origin);
      break;
    case COORD_SYSTEM_TOOLSUPPLY:
      sub_offset_xyz(&result, &offsets->toolsupply_origin);
      break;
  }

  return result;
}

float posp_dist(const pos_phys_t* a, const pos_phys_t* b) {
  const float PI = 3.14159265f;
  float dx = b->x - a->x;
  float dy = b->y - a->y;
  float dz = b->z - a->z;
  float dc = shortest_turn_delta(a->c, b->c);
  dc *= 2 * PI * 2;  // assume radius=2mm distance for C-axis
  return sqrtf(dx * dx + dy * dy + dz * dz + dc * dc);
}

void posp_interp(const pos_phys_t* a,
                 const pos_phys_t* b,
                 float t,
                 pos_phys_t* out) {
  out->x = a->x + (b->x - a->x) * t;
  out->y = a->y + (b->y - a->y) * t;
  out->z = a->z + (b->z - a->z) * t;

  // For C-axis, use shortest path interpolation
  float c_delta = shortest_turn_delta(a->c, b->c);
  out->c = wrap_turns(a->c + c_delta * t);
}

float wrap_turns(float turns) {
  // Wrap to [0, 1) range
  float result = fmodf(turns, 1.0f);
  if (result < 0.0f) {
    result += 1.0f;
  }
  return result;
}

float shortest_turn_delta(float current, float target) {
  // Calculate direct delta
  float delta = target - current;

  // Wrap to (-0.5, 0.5] range for shortest path
  if (delta > 0.5f) {
    delta -= 1.0f;
  } else if (delta <= -0.5f) {
    delta += 1.0f;
  }

  return delta;
}

char axis_to_letter(axis_t axis) {
  switch (axis) {
    case AXIS_X:
      return 'X';
    case AXIS_Y:
      return 'Y';
    case AXIS_Z:
      return 'Z';
    case AXIS_C:
      return 'C';
    default:
      return '?';
  }
}
```

## src/coords.h
```c
// SPDX-FileCopyrightText: 2025 夕月霞
// SPDX-License-Identifier: AGPL-3.0-or-later
/**
 * (Stateless) Coordinate system transformation utilities and fundamental
 * position type.
 */
#pragma once

/** Represents a single axis */
typedef enum {
  AXIS_X = 0,
  AXIS_Y = 1,
  AXIS_Z = 2,
  AXIS_C = 3,
} axis_t;

/** Represents a single physical coordinate. (i.e. coordinates specification in
 * G-code)
 */
typedef struct {
  float x;
  float y;
  float z;
  float c;  // turns in [0, 1)
} pos_phys_t;

/** Supported coordinate systems */
typedef enum {
  COORD_SYSTEM_MACHINE,     // G53 - Machine coordinates (default)
  COORD_SYSTEM_GRINDER,     // G54 - Grinder coordinates
  COORD_SYSTEM_WORK,        // G55 - Work coordinates
  COORD_SYSTEM_TOOLSUPPLY,  // G56 - Tool supply coordinates
} coord_system_t;

/** Coordinate system offsets.
 * All origins are stored in machine coordinates.
 */
typedef struct {
  pos_phys_t grinder_origin;     // G54 origin in machine coords
  pos_phys_t work_origin;        // G55 origin in machine coords
  pos_phys_t toolsupply_origin;  // G56 origin in machine coords
} coord_offsets_t;

/** Convert position from specified coordinate system to machine coordinates.
 * @param pos Position in source coordinate system
 * @param from_cs Source coordinate system
 * @param offsets Current coordinate system offsets
 * @return Position in machine coordinates
 */
pos_phys_t coords_to_machine(const pos_phys_t* pos,
                             coord_system_t from_cs,
                             const coord_offsets_t* offsets);

/** Convert position from machine coordinates to specified coordinate system.
 * @param machine_pos Position in machine coordinates
 * @param to_cs Target coordinate system
 * @param offsets Current coordinate system offsets
 * @return Position in target coordinate system
 */
pos_phys_t coords_from_machine(const pos_phys_t* machine_pos,
                               coord_system_t to_cs,
                               const coord_offsets_t* offsets);

/** Compute distance between two pos_phys_t points.
 *
 * TODO: definition of "distance" is very weird.
 * @return distance in mm
 */
float posp_dist(const pos_phys_t* a, const pos_phys_t* b);

/** Linearly interpolate between a (t=0), and b (t=1).
 * t can be outside of [0, 1] range, in which case it will be extrapolated.
 */
void posp_interp(const pos_phys_t* a,
                 const pos_phys_t* b,
                 float t,
                 pos_phys_t* out);

/** Wrap turn value to [0, 1) range.
 * @param turns Turn value
 * @return Wrapped value in [0, 1) range
 */
float wrap_turns(float turns);

/** Calculate shortest rotational delta between two turn positions.
 * @param current Current position in turns
 * @param target Target position in turns
 * @return Delta in turns to reach target via shortest path (-0.5, 0.5]
 */
float shortest_turn_delta(float current, float target);

/** Convert axis enum to letter character.
 * @param axis Axis enum value
 * @return Axis letter ('X', 'Y', 'Z', 'C') or '?' for invalid axis
 */
char axis_to_letter(axis_t axis);
```
