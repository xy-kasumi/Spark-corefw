## tests/app/testcase.yaml
```yaml
# SPDX-License-Identifier: CC0-1.0
tests:
  spark.app.gcode_base:
    tags: unit_test
  spark.app.motion_base:
    tags: unit_test
  spark.app.coords:
    tags: unit_test
  spark.app.slice:
    tags: unit_test
```
