## CMakeLists.txt
```
# SPDX-License-Identifier: CC0-1.0
cmake_minimum_required(VERSION 3.13.1)
find_package(Zephyr REQUIRED HINTS $ENV{ZEPHYR_BASE})

project(test_app LANGUAGES C)

# Include the source files we want to test
target_sources(app PRIVATE 
    ../../app/src/gcode_base.c
    ../../app/src/slice.c
    ../../app/src/motion_base.c
    ../../app/src/coords.c
    src/gcode_base_test.c
    src/slice_test.c
    src/motion_base_test.c
    src/coords_test.c
)

# Include directories
target_include_directories(app PRIVATE 
    ../../app/src
    ../../include
)
```

## prj.conf
```kconfig
# SPDX-License-Identifier: CC0-1.0
CONFIG_ZTEST=y
CONFIG_CONSOLE=y
CONFIG_UART_CONSOLE=y
CONFIG_STDOUT_CONSOLE=y
# path_buffer_t tests needs big stack
CONFIG_ZTEST_STACK_SIZE=4096

# Enable float printing
CONFIG_CBPRINTF_FP_SUPPORT=y
```

## src/coords_test.c
```c
// SPDX-FileCopyrightText: 2025 夕月霞
// SPDX-License-Identifier: AGPL-3.0-or-later
#include "coords.h"

#include <math.h>
#include <zephyr/ztest.h>

// Test posp_dist()
ZTEST(coords, test_posp_dist_basic) {
  pos_phys_t a = {0, 0, 0};
  pos_phys_t b = {3, 4, 0};  // 3-4-5 triangle
  zassert_within(posp_dist(&a, &b), 5.0f, 1e-4f, "Distance should be 5.0");
}

ZTEST(coords, test_posp_dist_zero) {
  pos_phys_t a = {1, 2, 3};
  zassert_within(posp_dist(&a, &a), 0.0f, 1e-4f,
                 "Same point distance should be 0");
}

ZTEST(coords, test_posp_dist_3d) {
  pos_phys_t a = {0, 0, 0};
  pos_phys_t b = {1, 1, 1};
  zassert_within(posp_dist(&a, &b), sqrtf(3.0f), 1e-4f, "3D diagonal distance");
}

// Test posp_interp()
ZTEST(coords, test_posp_interp_midpoint) {
  pos_phys_t a = {0, 0, 0};
  pos_phys_t b = {10, 20, 30};
  pos_phys_t result;
  posp_interp(&a, &b, 0.5f, &result);
  zassert_within(result.x, 5.0f, 1e-4f, "X midpoint");
  zassert_within(result.y, 10.0f, 1e-4f, "Y midpoint");
  zassert_within(result.z, 15.0f, 1e-4f, "Z midpoint");
}

ZTEST(coords, test_posp_interp_extrapolate) {
  pos_phys_t a = {0, 0, 0};
  pos_phys_t b = {10, 10, 10};
  pos_phys_t result;
  posp_interp(&a, &b, -0.5f, &result);  // Extrapolate backwards
  zassert_within(result.x, -5.0f, 1e-4f, "X extrapolation");
  zassert_within(result.y, -5.0f, 1e-4f, "Y extrapolation");
  zassert_within(result.z, -5.0f, 1e-4f, "Z extrapolation");
}

ZTEST(coords, test_posp_interp_endpoints) {
  pos_phys_t a = {1, 2, 3};
  pos_phys_t b = {4, 5, 6};
  pos_phys_t result;

  posp_interp(&a, &b, 0.0f, &result);
  zassert_within(result.x, 1.0f, 1e-4f, "t=0 should be point a");

  posp_interp(&a, &b, 1.0f, &result);
  zassert_within(result.x, 4.0f, 1e-4f, "t=1 should be point b");
}

ZTEST_SUITE(coords, NULL, NULL, NULL, NULL, NULL);
```

## src/gcode_base_test.c
```c
// SPDX-FileCopyrightText: 2025 夕月霞
// SPDX-License-Identifier: AGPL-3.0-or-later
#include "gcode_base.h"

#include <zephyr/ztest.h>

ZTEST(gcode_base, test_basic_g0_command) {
  gcode_parsed_t parsed;
  bool result = parse_gcode(sl_from_str("G0"), &parsed);

  zassert_true(result, "G0 command should parse successfully");
  zassert_equal(parsed.code, 0, "Code should be 0 for G0");
  zassert_equal(parsed.sub_code, -1, "Sub-code should be -1 for G0");
  zassert_equal(parsed.x_state, AXIS_NOT_SPECIFIED,
                "X should not be specified");
  zassert_equal(parsed.y_state, AXIS_NOT_SPECIFIED,
                "Y should not be specified");
  zassert_equal(parsed.z_state, AXIS_NOT_SPECIFIED,
                "Z should not be specified");
}

ZTEST(gcode_base, test_g38_2_command) {
  gcode_parsed_t parsed;
  bool result = parse_gcode(sl_from_str("G38.2"), &parsed);

  zassert_true(result, "G38.2 command should parse successfully");
  zassert_equal(parsed.code, 38, "Code should be 38 for G38.2");
  zassert_equal(parsed.sub_code, 2, "Sub-code should be 2 for G38.2");
  zassert_equal(parsed.x_state, AXIS_NOT_SPECIFIED,
                "X should not be specified");
  zassert_equal(parsed.y_state, AXIS_NOT_SPECIFIED,
                "Y should not be specified");
  zassert_equal(parsed.z_state, AXIS_NOT_SPECIFIED,
                "Z should not be specified");
}

ZTEST(gcode_base, test_g38_3_command) {
  gcode_parsed_t parsed;
  bool result = parse_gcode(sl_from_str("G38.3"), &parsed);

  zassert_true(result, "G38.3 command should parse successfully");
  zassert_equal(parsed.code, 38, "Code should be 38 for G38.3");
  zassert_equal(parsed.sub_code, 3, "Sub-code should be 3 for G38.3");
  zassert_equal(parsed.x_state, AXIS_NOT_SPECIFIED,
                "X should not be specified");
  zassert_equal(parsed.y_state, AXIS_NOT_SPECIFIED,
                "Y should not be specified");
  zassert_equal(parsed.z_state, AXIS_NOT_SPECIFIED,
                "Z should not be specified");
}

ZTEST(gcode_base, test_g1_with_coordinates) {
  gcode_parsed_t parsed;
  bool result = parse_gcode(sl_from_str("G1 X10.5 Y-20.3 Z5"), &parsed);

  zassert_true(result, "G1 with coordinates should parse successfully");
  zassert_equal(parsed.code, 1, "Code should be 1 for G1");
  zassert_equal(parsed.sub_code, -1, "Sub-code should be -1 for G1");
  zassert_equal(parsed.x_state, AXIS_WITH_VALUE, "X should have value");
  zassert_equal(parsed.y_state, AXIS_WITH_VALUE, "Y should have value");
  zassert_equal(parsed.z_state, AXIS_WITH_VALUE, "Z should have value");
  zassert_equal(parsed.x, 10.5f, "X should be 10.5");
  zassert_equal(parsed.y, -20.3f, "Y should be -20.3");
  zassert_equal(parsed.z, 5.0f, "Z should be 5.0");
}

ZTEST(gcode_base, test_g0_with_c_axis) {
  gcode_parsed_t parsed;
  bool result = parse_gcode(sl_from_str("G0 X10 Y20 C45.5"), &parsed);

  zassert_true(result, "G0 with C axis should parse successfully");
  zassert_equal(parsed.code, 0, "Code should be 0 for G0");
  zassert_equal(parsed.sub_code, -1, "Sub-code should be -1 for G0");
  zassert_equal(parsed.x_state, AXIS_WITH_VALUE, "X should have value");
  zassert_equal(parsed.y_state, AXIS_WITH_VALUE, "Y should have value");
  zassert_equal(parsed.c_state, AXIS_WITH_VALUE, "C should have value");
  zassert_equal(parsed.x, 10.0f, "X should be 10.0");
  zassert_equal(parsed.y, 20.0f, "Y should be 20.0");
  zassert_equal(parsed.c, 45.5f, "C should be 45.5");
}

ZTEST(gcode_base, test_g1_with_all_axes) {
  gcode_parsed_t parsed;
  bool result = parse_gcode(sl_from_str("G1 X1.5 Y2.5 Z3.5 C90"), &parsed);

  zassert_true(result, "G1 with all axes should parse successfully");
  zassert_equal(parsed.code, 1, "Code should be 1 for G1");
  zassert_equal(parsed.sub_code, -1, "Sub-code should be -1 for G1");
  zassert_equal(parsed.x_state, AXIS_WITH_VALUE, "X should have value");
  zassert_equal(parsed.y_state, AXIS_WITH_VALUE, "Y should have value");
  zassert_equal(parsed.z_state, AXIS_WITH_VALUE, "Z should have value");
  zassert_equal(parsed.c_state, AXIS_WITH_VALUE, "C should have value");
  zassert_equal(parsed.x, 1.5f, "X should be 1.5");
  zassert_equal(parsed.y, 2.5f, "Y should be 2.5");
  zassert_equal(parsed.z, 3.5f, "Z should be 3.5");
  zassert_equal(parsed.c, 90.0f, "C should be 90.0");
}

ZTEST(gcode_base, test_g28_axis_only) {
  gcode_parsed_t parsed;
  bool result = parse_gcode(sl_from_str("G28 X"), &parsed);

  zassert_true(result, "G28 X should parse successfully");
  zassert_equal(parsed.code, 28, "Code should be 28 for G28");
  zassert_equal(parsed.sub_code, -1, "Sub-code should be -1 for G28");
  zassert_equal(parsed.x_state, AXIS_ONLY, "X should be axis only");
  zassert_equal(parsed.y_state, AXIS_NOT_SPECIFIED,
                "Y should not be specified");
  zassert_equal(parsed.z_state, AXIS_NOT_SPECIFIED,
                "Z should not be specified");
}

ZTEST(gcode_base, test_g28_c_axis) {
  gcode_parsed_t parsed;
  bool result = parse_gcode(sl_from_str("G28 C"), &parsed);

  zassert_true(result, "G28 C should parse successfully");
  zassert_equal(parsed.code, 28, "Code should be 28 for G28");
  zassert_equal(parsed.sub_code, -1, "Sub-code should be -1 for G28");
  zassert_equal(parsed.c_state, AXIS_ONLY, "C should be axis only");
  zassert_equal(parsed.x_state, AXIS_NOT_SPECIFIED,
                "X should not be specified");
  zassert_equal(parsed.y_state, AXIS_NOT_SPECIFIED,
                "Y should not be specified");
  zassert_equal(parsed.z_state, AXIS_NOT_SPECIFIED,
                "Z should not be specified");
}

// M-code parsing tests
ZTEST(gcode_base, test_basic_m3_command) {
  gcode_parsed_t parsed;
  bool result = parse_gcode(sl_from_str("M3"), &parsed);

  zassert_true(result, "M3 command should parse successfully");
  zassert_equal(parsed.cmd_type, CMD_TYPE_M, "Command type should be M");
  zassert_equal(parsed.code, 3, "Code should be 3 for M3");
  zassert_equal(parsed.sub_code, -1, "Sub-code should be -1 for M3");
  zassert_equal(parsed.p_state, PARAM_NOT_SPECIFIED,
                "P should not be specified");
  zassert_equal(parsed.q_state, PARAM_NOT_SPECIFIED,
                "Q should not be specified");
  zassert_equal(parsed.r_state, PARAM_NOT_SPECIFIED,
                "R should not be specified");
}

ZTEST(gcode_base, test_m3_with_all_parameters) {
  gcode_parsed_t parsed;
  bool result = parse_gcode(sl_from_str("M3 P750 Q1.5 R30"), &parsed);

  zassert_true(result, "M3 with parameters should parse successfully");
  zassert_equal(parsed.cmd_type, CMD_TYPE_M, "Command type should be M");
  zassert_equal(parsed.code, 3, "Code should be 3 for M3");
  zassert_equal(parsed.sub_code, -1, "Sub-code should be -1 for M3");
  zassert_equal(parsed.p_state, PARAM_SPECIFIED, "P should be specified");
  zassert_equal(parsed.q_state, PARAM_SPECIFIED, "Q should be specified");
  zassert_equal(parsed.r_state, PARAM_SPECIFIED, "R should be specified");
  zassert_equal(parsed.p, 750.0f, "P should be 750.0");
  zassert_equal(parsed.q, 1.5f, "Q should be 1.5");
  zassert_equal(parsed.r, 30.0f, "R should be 30.0");
}

ZTEST(gcode_base, test_m4_with_partial_parameters) {
  gcode_parsed_t parsed;
  bool result = parse_gcode(sl_from_str("M4 Q2.0 R25"), &parsed);

  zassert_true(result, "M4 with partial parameters should parse successfully");
  zassert_equal(parsed.cmd_type, CMD_TYPE_M, "Command type should be M");
  zassert_equal(parsed.code, 4, "Code should be 4 for M4");
  zassert_equal(parsed.sub_code, -1, "Sub-code should be -1 for M4");
  zassert_equal(parsed.p_state, PARAM_NOT_SPECIFIED,
                "P should not be specified");
  zassert_equal(parsed.q_state, PARAM_SPECIFIED, "Q should be specified");
  zassert_equal(parsed.r_state, PARAM_SPECIFIED, "R should be specified");
  zassert_equal(parsed.q, 2.0f, "Q should be 2.0");
  zassert_equal(parsed.r, 25.0f, "R should be 25.0");
}

ZTEST(gcode_base, test_m5_command) {
  gcode_parsed_t parsed;
  bool result = parse_gcode(sl_from_str("M5"), &parsed);

  zassert_true(result, "M5 command should parse successfully");
  zassert_equal(parsed.cmd_type, CMD_TYPE_M, "Command type should be M");
  zassert_equal(parsed.code, 5, "Code should be 5 for M5");
  zassert_equal(parsed.sub_code, -1, "Sub-code should be -1 for M5");
  zassert_equal(parsed.p_state, PARAM_NOT_SPECIFIED,
                "P should not be specified");
  zassert_equal(parsed.q_state, PARAM_NOT_SPECIFIED,
                "Q should not be specified");
  zassert_equal(parsed.r_state, PARAM_NOT_SPECIFIED,
                "R should not be specified");
}

ZTEST(gcode_base, test_m_code_mixed_parameters) {
  gcode_parsed_t parsed;
  bool result = parse_gcode(sl_from_str("M3 P1000 R50"), &parsed);

  zassert_true(result, "M3 with mixed parameters should parse successfully");
  zassert_equal(parsed.cmd_type, CMD_TYPE_M, "Command type should be M");
  zassert_equal(parsed.code, 3, "Code should be 3 for M3");
  zassert_equal(parsed.p_state, PARAM_SPECIFIED, "P should be specified");
  zassert_equal(parsed.q_state, PARAM_NOT_SPECIFIED,
                "Q should not be specified");
  zassert_equal(parsed.r_state, PARAM_SPECIFIED, "R should be specified");
  zassert_equal(parsed.p, 1000.0f, "P should be 1000.0");
  zassert_equal(parsed.r, 50.0f, "R should be 50.0");
}

ZTEST(gcode_base, test_invalid_m_code_parameter) {
  gcode_parsed_t parsed;
  bool result = parse_gcode(sl_from_str("M3 P"), &parsed);

  zassert_false(result, "M3 with bare P should fail to parse");
}

ZTEST(gcode_base, test_m_code_with_unknown_parameter) {
  gcode_parsed_t parsed;
  bool result = parse_gcode(sl_from_str("M3 P500 S100"), &parsed);

  zassert_false(result, "M3 with unknown parameter S should fail to parse");
}

ZTEST(gcode_base, test_invalid_m_code_number) {
  gcode_parsed_t parsed;
  bool result = parse_gcode(sl_from_str("M999"), &parsed);

  zassert_true(
      result,
      "M999 should parse successfully (validation happens in execution)");
  zassert_equal(parsed.cmd_type, CMD_TYPE_M, "Command type should be M");
  zassert_equal(parsed.code, 999, "Code should be 999");
}

// Parse failure test cases
ZTEST(gcode_base, test_empty_string) {
  gcode_parsed_t parsed;
  bool result = parse_gcode(sl_from_str(""), &parsed);

  zassert_false(result, "Empty string should fail to parse");
}

ZTEST(gcode_base, test_whitespace_only) {
  gcode_parsed_t parsed;
  bool result = parse_gcode(sl_from_str("   "), &parsed);

  zassert_false(result, "Whitespace-only string should fail to parse");
}

ZTEST(gcode_base, test_extra_whitespace_success) {
  gcode_parsed_t parsed;
  bool result = parse_gcode(sl_from_str("G0   X10.5    Y20"), &parsed);

  zassert_true(result, "Extra whitespace should be handled gracefully");
  zassert_equal(parsed.cmd_type, CMD_TYPE_G, "Command type should be G");
  zassert_equal(parsed.code, 0, "Code should be 0");
  zassert_equal(parsed.x_state, AXIS_WITH_VALUE, "X should have value");
  zassert_equal(parsed.y_state, AXIS_WITH_VALUE, "Y should have value");
  zassert_equal(parsed.x, 10.5f, "X should be 10.5");
  zassert_equal(parsed.y, 20.0f, "Y should be 20.0");
}

ZTEST(gcode_base, test_lowercase_command) {
  gcode_parsed_t parsed;
  bool result = parse_gcode(sl_from_str("g0 X10"), &parsed);

  zassert_false(result, "Lowercase command should fail to parse");
}

ZTEST(gcode_base, test_lowercase_parameter) {
  gcode_parsed_t parsed;
  bool result = parse_gcode(sl_from_str("G0 x10"), &parsed);

  zassert_false(result, "Lowercase parameter should fail to parse");
}

ZTEST(gcode_base, test_garbled_command) {
  gcode_parsed_t parsed;
  bool result = parse_gcode(sl_from_str("G0abc X10"), &parsed);

  zassert_false(result, "Garbled command should fail to parse");
}

ZTEST(gcode_base, test_garbled_number) {
  gcode_parsed_t parsed;
  bool result = parse_gcode(sl_from_str("G0 X10.5.2"), &parsed);

  zassert_false(result, "Garbled number should fail to parse");
}

ZTEST(gcode_base, test_no_whitespace_between_params) {
  gcode_parsed_t parsed;
  bool result = parse_gcode(sl_from_str("G0X1Y2"), &parsed);

  zassert_false(result,
                "No whitespace between parameters should fail to parse");
}

ZTEST(gcode_base, test_invalid_decimal_format) {
  gcode_parsed_t parsed;
  bool result = parse_gcode(sl_from_str("M3 P10..5"), &parsed);

  zassert_false(result,
                "Invalid decimal format (double decimal) should fail to parse");
}

ZTEST_SUITE(gcode_base, NULL, NULL, NULL, NULL, NULL);
```

## src/gcode_test.c
```c
// SPDX-FileCopyrightText: 2025 夕月霞
// SPDX-License-Identifier: AGPL-3.0-or-later
#include "gcode.h"
#include <zephyr/ztest.h>

ZTEST(gcode, test_basic_g0_command) {
  gcode_parsed_t parsed;
  bool result = parse_gcode("G0", &parsed);

  zassert_true(result, "G0 command should parse successfully");
  zassert_equal(parsed.code, 0, "Code should be 0 for G0");
  zassert_equal(parsed.sub_code, -1, "Sub-code should be -1 for G0");
  zassert_equal(parsed.x_state, AXIS_NOT_SPECIFIED,
                "X should not be specified");
  zassert_equal(parsed.y_state, AXIS_NOT_SPECIFIED,
                "Y should not be specified");
  zassert_equal(parsed.z_state, AXIS_NOT_SPECIFIED,
                "Z should not be specified");
}

ZTEST(gcode, test_g38_2_command) {
  gcode_parsed_t parsed;
  bool result = parse_gcode("G38.2", &parsed);

  zassert_true(result, "G38.2 command should parse successfully");
  zassert_equal(parsed.code, 38, "Code should be 38 for G38.2");
  zassert_equal(parsed.sub_code, 2, "Sub-code should be 2 for G38.2");
  zassert_equal(parsed.x_state, AXIS_NOT_SPECIFIED,
                "X should not be specified");
  zassert_equal(parsed.y_state, AXIS_NOT_SPECIFIED,
                "Y should not be specified");
  zassert_equal(parsed.z_state, AXIS_NOT_SPECIFIED,
                "Z should not be specified");
}

ZTEST(gcode, test_g1_with_coordinates) {
  gcode_parsed_t parsed;
  bool result = parse_gcode("G1 X10.5 Y-20.3 Z5", &parsed);

  zassert_true(result, "G1 with coordinates should parse successfully");
  zassert_equal(parsed.code, 1, "Code should be 1 for G1");
  zassert_equal(parsed.sub_code, -1, "Sub-code should be -1 for G1");
  zassert_equal(parsed.x_state, AXIS_WITH_VALUE, "X should have value");
  zassert_equal(parsed.y_state, AXIS_WITH_VALUE, "Y should have value");
  zassert_equal(parsed.z_state, AXIS_WITH_VALUE, "Z should have value");
  zassert_equal(parsed.x, 10.5f, "X should be 10.5");
  zassert_equal(parsed.y, -20.3f, "Y should be -20.3");
  zassert_equal(parsed.z, 5.0f, "Z should be 5.0");
}

ZTEST(gcode, test_g28_axis_only) {
  gcode_parsed_t parsed;
  bool result = parse_gcode("G28 X", &parsed);

  zassert_true(result, "G28 X should parse successfully");
  zassert_equal(parsed.code, 28, "Code should be 28 for G28");
  zassert_equal(parsed.sub_code, -1, "Sub-code should be -1 for G28");
  zassert_equal(parsed.x_state, AXIS_ONLY, "X should be axis only");
  zassert_equal(parsed.y_state, AXIS_NOT_SPECIFIED,
                "Y should not be specified");
  zassert_equal(parsed.z_state, AXIS_NOT_SPECIFIED,
                "Z should not be specified");
}

// M-code parsing tests
ZTEST(gcode, test_basic_m3_command) {
  gcode_parsed_t parsed;
  bool result = parse_gcode("M3", &parsed);

  zassert_true(result, "M3 command should parse successfully");
  zassert_equal(parsed.cmd_type, CMD_TYPE_M, "Command type should be M");
  zassert_equal(parsed.code, 3, "Code should be 3 for M3");
  zassert_equal(parsed.sub_code, -1, "Sub-code should be -1 for M3");
  zassert_equal(parsed.p_state, PARAM_NOT_SPECIFIED,
                "P should not be specified");
  zassert_equal(parsed.q_state, PARAM_NOT_SPECIFIED,
                "Q should not be specified");
  zassert_equal(parsed.r_state, PARAM_NOT_SPECIFIED,
                "R should not be specified");
}

ZTEST(gcode, test_m3_with_all_parameters) {
  gcode_parsed_t parsed;
  bool result = parse_gcode("M3 P750 Q1.5 R30", &parsed);

  zassert_true(result, "M3 with parameters should parse successfully");
  zassert_equal(parsed.cmd_type, CMD_TYPE_M, "Command type should be M");
  zassert_equal(parsed.code, 3, "Code should be 3 for M3");
  zassert_equal(parsed.sub_code, -1, "Sub-code should be -1 for M3");
  zassert_equal(parsed.p_state, PARAM_SPECIFIED, "P should be specified");
  zassert_equal(parsed.q_state, PARAM_SPECIFIED, "Q should be specified");
  zassert_equal(parsed.r_state, PARAM_SPECIFIED, "R should be specified");
  zassert_equal(parsed.p, 750.0f, "P should be 750.0");
  zassert_equal(parsed.q, 1.5f, "Q should be 1.5");
  zassert_equal(parsed.r, 30.0f, "R should be 30.0");
}

ZTEST(gcode, test_m4_with_partial_parameters) {
  gcode_parsed_t parsed;
  bool result = parse_gcode("M4 Q2.0 R25", &parsed);

  zassert_true(result, "M4 with partial parameters should parse successfully");
  zassert_equal(parsed.cmd_type, CMD_TYPE_M, "Command type should be M");
  zassert_equal(parsed.code, 4, "Code should be 4 for M4");
  zassert_equal(parsed.sub_code, -1, "Sub-code should be -1 for M4");
  zassert_equal(parsed.p_state, PARAM_NOT_SPECIFIED,
                "P should not be specified");
  zassert_equal(parsed.q_state, PARAM_SPECIFIED, "Q should be specified");
  zassert_equal(parsed.r_state, PARAM_SPECIFIED, "R should be specified");
  zassert_equal(parsed.q, 2.0f, "Q should be 2.0");
  zassert_equal(parsed.r, 25.0f, "R should be 25.0");
}

ZTEST(gcode, test_m5_command) {
  gcode_parsed_t parsed;
  bool result = parse_gcode("M5", &parsed);

  zassert_true(result, "M5 command should parse successfully");
  zassert_equal(parsed.cmd_type, CMD_TYPE_M, "Command type should be M");
  zassert_equal(parsed.code, 5, "Code should be 5 for M5");
  zassert_equal(parsed.sub_code, -1, "Sub-code should be -1 for M5");
  zassert_equal(parsed.p_state, PARAM_NOT_SPECIFIED,
                "P should not be specified");
  zassert_equal(parsed.q_state, PARAM_NOT_SPECIFIED,
                "Q should not be specified");
  zassert_equal(parsed.r_state, PARAM_NOT_SPECIFIED,
                "R should not be specified");
}

ZTEST(gcode, test_m_code_mixed_parameters) {
  gcode_parsed_t parsed;
  bool result = parse_gcode("M3 P1000 R50", &parsed);

  zassert_true(result, "M3 with mixed parameters should parse successfully");
  zassert_equal(parsed.cmd_type, CMD_TYPE_M, "Command type should be M");
  zassert_equal(parsed.code, 3, "Code should be 3 for M3");
  zassert_equal(parsed.p_state, PARAM_SPECIFIED, "P should be specified");
  zassert_equal(parsed.q_state, PARAM_NOT_SPECIFIED,
                "Q should not be specified");
  zassert_equal(parsed.r_state, PARAM_SPECIFIED, "R should be specified");
  zassert_equal(parsed.p, 1000.0f, "P should be 1000.0");
  zassert_equal(parsed.r, 50.0f, "R should be 50.0");
}

ZTEST(gcode, test_invalid_m_code_parameter) {
  gcode_parsed_t parsed;
  bool result = parse_gcode("M3 P", &parsed);

  zassert_false(result, "M3 with bare P should fail to parse");
}

ZTEST(gcode, test_m_code_with_unknown_parameter) {
  gcode_parsed_t parsed;
  bool result = parse_gcode("M3 P500 S100", &parsed);

  zassert_false(result, "M3 with unknown parameter S should fail to parse");
}

ZTEST(gcode, test_invalid_m_code_number) {
  gcode_parsed_t parsed;
  bool result = parse_gcode("M999", &parsed);

  zassert_true(
      result,
      "M999 should parse successfully (validation happens in execution)");
  zassert_equal(parsed.cmd_type, CMD_TYPE_M, "Command type should be M");
  zassert_equal(parsed.code, 999, "Code should be 999");
}

// Parse failure test cases
ZTEST(gcode, test_empty_string) {
  gcode_parsed_t parsed;
  bool result = parse_gcode("", &parsed);

  zassert_false(result, "Empty string should fail to parse");
}

ZTEST(gcode, test_whitespace_only) {
  gcode_parsed_t parsed;
  bool result = parse_gcode("   ", &parsed);

  zassert_false(result, "Whitespace-only string should fail to parse");
}

ZTEST(gcode, test_extra_whitespace_success) {
  gcode_parsed_t parsed;
  bool result = parse_gcode("G0   X10.5    Y20", &parsed);

  zassert_true(result, "Extra whitespace should be handled gracefully");
  zassert_equal(parsed.cmd_type, CMD_TYPE_G, "Command type should be G");
  zassert_equal(parsed.code, 0, "Code should be 0");
  zassert_equal(parsed.x_state, AXIS_WITH_VALUE, "X should have value");
  zassert_equal(parsed.y_state, AXIS_WITH_VALUE, "Y should have value");
  zassert_equal(parsed.x, 10.5f, "X should be 10.5");
  zassert_equal(parsed.y, 20.0f, "Y should be 20.0");
}

ZTEST(gcode, test_lowercase_command) {
  gcode_parsed_t parsed;
  bool result = parse_gcode("g0 X10", &parsed);

  zassert_false(result, "Lowercase command should fail to parse");
}

ZTEST(gcode, test_lowercase_parameter) {
  gcode_parsed_t parsed;
  bool result = parse_gcode("G0 x10", &parsed);

  zassert_false(result, "Lowercase parameter should fail to parse");
}

ZTEST(gcode, test_garbled_command) {
  gcode_parsed_t parsed;
  bool result = parse_gcode("G0abc X10", &parsed);

  zassert_false(result, "Garbled command should fail to parse");
}

ZTEST(gcode, test_garbled_number) {
  gcode_parsed_t parsed;
  bool result = parse_gcode("G0 X10.5.2", &parsed);

  zassert_false(result, "Garbled number should fail to parse");
}

ZTEST(gcode, test_no_whitespace_between_params) {
  gcode_parsed_t parsed;
  bool result = parse_gcode("G0X1Y2", &parsed);

  zassert_false(result,
                "No whitespace between parameters should fail to parse");
}

ZTEST(gcode, test_invalid_decimal_format) {
  gcode_parsed_t parsed;
  bool result = parse_gcode("M3 P10..5", &parsed);

  zassert_false(result,
                "Invalid decimal format (double decimal) should fail to parse");
}

ZTEST_SUITE(gcode, NULL, NULL, NULL, NULL, NULL);
```

## src/motion_base_test.c
```c
// SPDX-FileCopyrightText: 2025 夕月霞
// SPDX-License-Identifier: AGPL-3.0-or-later
#include "motion_base.h"

#include <zephyr/ztest.h>

// Float version of zassert_within, with value printing
#define zassert_within_f(a, b, d, ...)                                      \
  zassert(((a) >= ((b) - (d))) && ((a) <= ((b) + (d))),                     \
          #a " not within " #b " +/- " #d, "observed=%g, expected=[%g,%g]", \
          (double)(a), (double)((b) - (d)), (double)((b) + (d)),            \
          ##__VA_ARGS__)

// Test path_buffer_t initialization
ZTEST(motion_base, test_pb_init_basic) {
  path_buffer_t pb;
  pos_phys_t src = {0, 0, 0};
  pos_phys_t dst = {10, 0, 0};

  pb_init(&pb, &src, &dst);

  pos_phys_t pos = pb_get_pos(&pb);
  zassert_within_f(pos.x, 0.0f, 1e-4f, "initial pos");
  zassert_true(pb_can_write(&pb), "buffer available after construction");
  zassert_false(pb_at_end(&pb), "initial pos is not end");
}

// Test path_buffer_t movement
ZTEST(motion_base, test_pb_move_forward_simple) {
  path_buffer_t pb;
  pos_phys_t src = {0, 0, 0};
  pos_phys_t dst = {1, 0, 0};  // 1mm segment

  pb_init(&pb, &src, &dst);

  // Move 0.5mm forward
  zassert_true(pb_move(&pb, 0.5f), "move forward should succeed");
  pos_phys_t pos = pb_get_pos(&pb);
  zassert_within_f(pos.x, 0.5f, EDM_RESOLUTION_MM + 1e-4f,
                   "should be at 0.5mm");
}

ZTEST(motion_base, test_pb_move_backward) {
  path_buffer_t pb;
  pos_phys_t src = {0, 0, 0};
  pos_phys_t dst = {1, 0, 0};

  pb_init(&pb, &src, &dst);

  // Move forward then backward
  pb_move(&pb, 0.5f);
  zassert_true(pb_move(&pb, -0.2f), "move backward should succeed");
  pos_phys_t pos = pb_get_pos(&pb);
  zassert_within_f(pos.x, 0.3f, EDM_RESOLUTION_MM + 1e-4f,
                   "should be at 0.3mm (+0.5mm - 0.2mm)");
}

ZTEST(motion_base, test_pb_move_retraction_limit) {
  path_buffer_t pb;
  pos_phys_t src = {0, 0, 0};
  pos_phys_t dst = {10, 0, 0};

  pb_init(&pb, &src, &dst);

  // Move forward much more than history size can track
  // EDM_HISTORY_SIZE=201, EDM_RESOLUTION_MM=0.005, so max history ~1mm
  pb_move(&pb, 5.0f);  // Move 5mm forward (way beyond history)

  // Try to retract way beyond limit - should fail
  zassert_false(pb_move(&pb, -10.0f),
                "Retraction beyond history limit should fail");
}

ZTEST(motion_base, test_pb_move_to_end) {
  path_buffer_t pb;
  pos_phys_t src = {0, 0, 0};
  pos_phys_t dst = {0.5f, 0, 0};  // Short segment

  pb_init(&pb, &src, &dst);

  // Move beyond current end
  pb_move(&pb, 1.0f);  // Try to move 1mm (> 0.5mm)

  zassert_true(pb_at_end(&pb), "Should be at end after overshooting");
  pos_phys_t pos = pb_get_pos(&pb);
  zassert_within_f(pos.x, 0.5f, EDM_RESOLUTION_MM + 1e-4f,
                   "Should be clipped to segment end");
}

// Test path_buffer_t multi-segment
ZTEST(motion_base, test_pb_write_and_traverse) {
  path_buffer_t pb;
  pos_phys_t p1 = {0, 0, 0};
  pos_phys_t p2 = {1, 0, 0};
  pos_phys_t p3 = {1, 1, 0};  // L-shaped path

  pb_init(&pb, &p1, &p2);

  zassert_true(pb_can_write(&pb), "Should be able to write to non-end segment");
  pb_write(&pb, &p3);

  // Move through both segments
  pb_move(&pb, 1.5f);  // Should be halfway through second segment
  pos_phys_t pos = pb_get_pos(&pb);
  zassert_within_f(pos.x, 1.0f, EDM_RESOLUTION_MM + 1e-4f,
                   "X must be middle of p2-p3 segment");
  zassert_within_f(pos.y, 0.5f, EDM_RESOLUTION_MM + 1e-4f,
                   "Y must be middle of p2-p3 segment");
  zassert_false(pb_at_end(&pb), "not ended yet (1.5 of 2.0)");

  // Complete the move
  pb_move(&pb, 0.5f);
  zassert_true(pb_at_end(&pb), "must be ended (2.0 of 2.0)");
}

ZTEST(motion_base, test_pb_write_check_middle) {
  path_buffer_t pb;
  pos_phys_t p1 = {0, 0, 0};
  pos_phys_t p2 = {1, 0, 0};
  pos_phys_t p3 = {1, 1, 0};  // L-shaped path

  pb_init(&pb, &p1, &p2);

  zassert_true(pb_can_write(&pb), "Should be able to write to non-end segment");
  pb_write(&pb, &p3);

  // Move to p2
  pb_move(&pb, 1.0f);
  pos_phys_t pos = pb_get_pos(&pb);
  zassert_within_f(pos.x, 1.0f, EDM_RESOLUTION_MM + 1e-4f, "X must be p2");
  zassert_within_f(pos.y, 0.0f, EDM_RESOLUTION_MM + 1e-4f, "Y must be p2");
  zassert_false(pb_at_end(&pb), "not ended yet (1.0 of 2.0)");
}

ZTEST(motion_base, test_pb_write_buffer_full) {
  path_buffer_t pb;
  pos_phys_t p1 = {0, 0, 0};
  pos_phys_t p2 = {1, 0, 0};
  pos_phys_t p3 = {2, 0, 0};

  pb_init(&pb, &p1, &p2);
  pb_write(&pb, &p3);  // Fill the buffer
  zassert_false(pb_can_write(&pb), "buffer should be full");

  // Move to consume the buffered segment
  pb_move(&pb, 1.1f);  // Move past first segment
  zassert_true(pb_can_write(&pb), "first segment must be consumed");
}

// Test edge cases
ZTEST(motion_base, test_pb_tiny_movements) {
  path_buffer_t pb;
  pos_phys_t src = {0, 0, 0};
  pos_phys_t dst = {1, 0, 0};

  pb_init(&pb, &src, &dst);

  // Move less than EDM_RESOLUTION_MM - should not change position
  pos_phys_t pos_before = pb_get_pos(&pb);
  pb_move(&pb, EDM_RESOLUTION_MM * 0.5f);
  pos_phys_t pos_after = pb_get_pos(&pb);

  zassert_within_f(pos_before.x, pos_after.x, 1e-4f,
                   "Tiny movement should not change discrete position");
}

ZTEST(motion_base, test_pb_zero_length_segment) {
  path_buffer_t pb;
  pos_phys_t same = {5, 5, 5};

  pb_init(&pb, &same, &same);  // Zero-length segment

  pb_move(&pb, 1.0f);  // Should not crash
  zassert_true(pb_at_end(&pb), "Zero-length segment should be at end");

  pos_phys_t pos = pb_get_pos(&pb);
  zassert_within_f(pos.x, 5.0f, 1e-4f, "Should stay at same position");
}

ZTEST(motion_base, test_pb_accumulated_tiny_movements) {
  path_buffer_t pb;
  pos_phys_t src = {0, 0, 0};
  pos_phys_t dst = {1, 0, 0};

  pb_init(&pb, &src, &dst);

  // Accumulate tiny movements until they add up to one notch
  float tiny = EDM_RESOLUTION_MM * 0.3f;
  pb_move(&pb, tiny);  // 0.3 * 0.005 = 0.0015mm
  pb_move(&pb, tiny);  // 0.6 * 0.005 = 0.003mm
  pb_move(&pb, tiny);  // 0.9 * 0.005 = 0.0045mm
  pb_move(&pb, tiny);  // 1.2 * 0.005 = 0.006mm -> should trigger one notch

  pos_phys_t pos = pb_get_pos(&pb);
  zassert_true(pos.x >= EDM_RESOLUTION_MM - 1e-4f,
               "Accumulated tiny movements should eventually advance position");
}

ZTEST(motion_base, test_pb_get_buffers) {
  path_buffer_t pb;
  pos_phys_t src = {0, 0, 0};
  pos_phys_t dst = {1, 0, 0};

  pb_init(&pb, &src, &dst);
  zassert_within_f(pb_get_forward_buffer(&pb), 1.0f, EDM_RESOLUTION_MM);
  zassert_within_f(pb_get_backward_buffer(&pb), 0.0f, EDM_RESOLUTION_MM);

  pb_move(&pb, 0.25);
  zassert_within_f(pb_get_forward_buffer(&pb), 0.75f, EDM_RESOLUTION_MM);
  zassert_within_f(pb_get_backward_buffer(&pb), 0.25f, EDM_RESOLUTION_MM);

  pb_move(&pb, 0.75);
  zassert_within_f(pb_get_forward_buffer(&pb), 0.0f, EDM_RESOLUTION_MM);
  zassert_within_f(pb_get_backward_buffer(&pb), 1.0f, EDM_RESOLUTION_MM);
}

ZTEST(motion_base, test_pb_get_buffers_added) {
  path_buffer_t pb;
  pos_phys_t src = {0, 0, 0};
  pos_phys_t p1 = {1, 0, 0};
  pos_phys_t p2 = {1, 1, 0};

  pb_init(&pb, &src, &p1);
  pb_write(&pb, &p2);
  zassert_within_f(pb_get_forward_buffer(&pb), 2, EDM_RESOLUTION_MM);
  zassert_within_f(pb_get_backward_buffer(&pb), 0, EDM_RESOLUTION_MM);

  pb_move(&pb, 1.5f);
  zassert_within_f(pb_get_forward_buffer(&pb), 0.5f,
                   EDM_RESOLUTION_MM);  // to p2
  zassert_within_f(pb_get_backward_buffer(&pb),
                   (EDM_HISTORY_SIZE - 1) * EDM_RESOLUTION_MM,
                   EDM_RESOLUTION_MM);  // 2, but some history gone
}

ZTEST(motion_base, test_pb_get_distance) {
  path_buffer_t pb;
  pos_phys_t src = {0, 0, 0};
  pos_phys_t p1 = {1, 0, 0};
  pos_phys_t p2 = {1, 1, 0};

  pb_init(&pb, &src, &p1);
  zassert_within_f(pb_get_distance(&pb), 0, EDM_RESOLUTION_MM);

  pb_move(&pb, 0.5f);  // now at 0
  zassert_within_f(pb_get_distance(&pb), 0.5f, EDM_RESOLUTION_MM);

  pb_move(&pb, -0.25f);  // now at 0.25
  zassert_within_f(pb_get_distance(&pb), 0.25f, EDM_RESOLUTION_MM);

  pb_write(&pb, &p2);
  pb_move(&pb, 1.0f);  // now at 1.25
  zassert_within_f(pb_get_distance(&pb), 1.25f, EDM_RESOLUTION_MM);

  pb_move(&pb, 100.0f);  // now at 2
  zassert_within_f(pb_get_distance(&pb), 2.0f, EDM_RESOLUTION_MM);

  pb_move(&pb, -50.0f);  // now at (max retract from 2.0)
  zassert_within_f(pb_get_distance(&pb),
                   2.0f - ((EDM_HISTORY_SIZE - 1) * EDM_RESOLUTION_MM),
                   EDM_RESOLUTION_MM);
}

ZTEST_SUITE(motion_base, NULL, NULL, NULL, NULL, NULL);
```

## src/slice_test.c
```c
// SPDX-FileCopyrightText: 2025 夕月霞
// SPDX-License-Identifier: AGPL-3.0-or-later
#include "slice.h"

#include <zephyr/ztest.h>

ZTEST(slice, test_sl_is_empty) {
  zassert_true(sl_is_empty(sl_empty()));
  zassert_true(sl_is_empty(sl_from_str("")));
  zassert_false(sl_is_empty(sl_from_str("abc")));
}

ZTEST(slice, test_sl_eq) {
  zassert_true(sl_eq(sl_empty(), sl_empty()));
  zassert_true(sl_eq(sl_from_str("abc"), sl_from_str("abc")));

  {
    uint8_t buf1[1];
    uint8_t buf2[1];
    buf1[0] = 'a';
    buf2[0] = 'a';
    slice_t s1 = {.size = 1, .ptr = buf1};
    slice_t s2 = {.size = 1, .ptr = buf2};
    zassert_true(sl_eq(s1, s2), "different pointer, same content");
  }

  {
    uint8_t buf1[2];
    uint8_t buf2[2];
    slice_t s1 = {.size = 2, .ptr = buf1};
    slice_t s2 = {.size = 2, .ptr = buf2};
    buf1[0] = 0;
    buf1[1] = 'a';
    buf2[0] = 0;
    buf2[1] = 'a';
    zassert_true(sl_eq(s1, s2), "content after null matters");

    buf1[0] = 0;
    buf1[1] = 'a';
    buf2[0] = 0;
    buf2[1] = 'b';
    zassert_false(sl_eq(s1, s2), "content after null matters");
  }
}

ZTEST(slice, test_sl_eq_str) {
  zassert_true(sl_eq_str(sl_empty(), ""));
  zassert_true(sl_eq_str(sl_from_str("abc"), "abc"));

  zassert_false(sl_eq_str(sl_empty(), "a"));
  zassert_false(sl_eq_str(sl_from_str("a"), ""));
}

ZTEST(slice, test_sl_sub) {
  slice_t s = sl_from_str("abc");

  // basic use cases
  zassert_true(sl_eq_str(sl_sub(s, 0, 3), "abc"));
  zassert_true(sl_eq_str(sl_sub(s, 0, 2), "ab"));
  zassert_true(sl_eq_str(sl_sub(s, 1, 3), "bc"));
  zassert_true(sl_eq_str(sl_sub(s, 0, 0), ""));

  // edge cases
  zassert_true(sl_eq_str(sl_sub(s, 0, 10), "abc"));
  zassert_true(sl_eq_str(sl_sub(s, -10, 3), "abc"));
  zassert_true(sl_eq_str(sl_sub(s, 3, 0), ""));
}

ZTEST(slice, test_sl_split_at) {
  slice_t ret, rem;

  ret = sl_split_at(sl_from_str("a.b.c"), '.', &rem);
  zassert_true(sl_eq_str(ret, "a"));
  zassert_true(sl_eq_str(rem, "b.c"));

  ret = sl_split_at(sl_from_str("a."), '.', &rem);
  zassert_true(sl_eq_str(ret, "a"));
  zassert_true(sl_is_empty(rem));

  ret = sl_split_at(sl_from_str("a"), '.', &rem);
  zassert_true(sl_eq_str(ret, "a"));
  zassert_true(sl_is_empty(rem));

  ret = sl_split_at(sl_from_str(".a"), '.', &rem);
  zassert_true(sl_is_empty(ret));
  zassert_true(sl_eq_str(rem, "a"));

  ret = sl_split_at(sl_from_str("."), '.', &rem);
  zassert_true(sl_is_empty(ret));
  zassert_true(sl_is_empty(rem));

  ret = sl_split_at(sl_from_str(""), '.', &rem);
  zassert_true(sl_is_empty(ret));
  zassert_true(sl_is_empty(rem));
}

ZTEST(slice, test_sl_split_at_null_rem) {
  slice_t ret = sl_split_at(sl_from_str("a.b.c"), '.', NULL);
  zassert_true(sl_eq_str(ret, "a"));
}

ZTEST(slice, test_sl_split_by_spaces) {
  slice_t ret, rem;

  ret = sl_split_by_spaces(sl_from_str("a  b  c"), &rem);
  zassert_true(sl_eq_str(ret, "a"));
  zassert_true(sl_eq_str(rem, "b  c"));

  ret = sl_split_by_spaces(sl_from_str("a "), &rem);
  zassert_true(sl_eq_str(ret, "a"));
  zassert_true(sl_is_empty(rem));

  ret = sl_split_by_spaces(sl_from_str("a"), &rem);
  zassert_true(sl_eq_str(ret, "a"));
  zassert_true(sl_is_empty(rem));

  ret = sl_split_by_spaces(sl_from_str(" a"), &rem);
  zassert_true(sl_is_empty(ret));
  zassert_true(sl_eq_str(rem, "a"));

  ret = sl_split_by_spaces(sl_from_str("  "), &rem);
  zassert_true(sl_is_empty(ret));
  zassert_true(sl_is_empty(rem));

  ret = sl_split_by_spaces(sl_from_str(""), &rem);
  zassert_true(sl_is_empty(ret));
  zassert_true(sl_is_empty(rem));
}

ZTEST(slice, test_sl_split_by_spaces_null_rem) {
  slice_t ret;

  ret = sl_split_by_spaces(sl_from_str("a  b  c"), NULL);
  zassert_true(sl_eq_str(ret, "a"));

  ret = sl_split_by_spaces(sl_from_str("a "), NULL);
  zassert_true(sl_eq_str(ret, "a"));

  ret = sl_split_by_spaces(sl_from_str("a"), NULL);
  zassert_true(sl_eq_str(ret, "a"));

  ret = sl_split_by_spaces(sl_from_str(" a"), NULL);
  zassert_true(sl_is_empty(ret));

  ret = sl_split_by_spaces(sl_from_str("  "), NULL);
  zassert_true(sl_is_empty(ret));

  ret = sl_split_by_spaces(sl_from_str(""), NULL);
  zassert_true(sl_is_empty(ret));
}

ZTEST(slice, test_sl_parse_int_valid) {
  int value;
  zassert_true(sl_parse_int(sl_from_str("123"), &value));
  zassert_equal(value, 123);

  zassert_true(sl_parse_int(sl_from_str("-456"), &value));
  zassert_equal(value, -456);

  zassert_true(sl_parse_int(sl_from_str("0"), &value));
  zassert_equal(value, 0);

  zassert_true(sl_parse_int(sl_from_str("2147483647"), &value), "max int32");
  zassert_equal(value, 2147483647);

  zassert_true(sl_parse_int(sl_from_str("-2147483648"), &value), "min int32");
  zassert_equal(value, -2147483648);
}

ZTEST(slice, test_sl_parse_int_invalid) {
  int value;
  zassert_false(sl_parse_int(sl_from_str(" 123"), &value), "pre-space");
  zassert_false(sl_parse_int(sl_from_str("123 "), &value), "post-space");
  zassert_false(sl_parse_int(sl_from_str("1.2"), &value), "float");
  zassert_false(sl_parse_int(sl_from_str("0x123"), &value), "hex");
  zassert_false(sl_parse_int(sl_from_str("1000000000000000"), &value),
                "bigint");
}

ZTEST(slice, test_sl_parse_float_valid) {
  float value;
  zassert_true(sl_parse_float(sl_from_str("123.45"), &value));
  zassert_equal(value, 123.45f);

  zassert_true(sl_parse_float(sl_from_str("1.2345e2"), &value));
  zassert_equal(value, 123.45f);
}

ZTEST(slice, test_sl_parse_float_invalid) {
  float value;
  zassert_false(sl_parse_float(sl_from_str(" 123.45"), &value), "pre-space");
  zassert_false(sl_parse_float(sl_from_str("123.45 "), &value), "post-space");
  zassert_false(sl_parse_float(sl_from_str("12.3.4"), &value), "multi-dot");
  zassert_false(sl_parse_float(sl_from_str("1e1000"), &value), "big float");
  zassert_false(sl_parse_float(sl_from_str("NAN"), &value), "NAN");
  zassert_false(sl_parse_float(sl_from_str("INF"), &value), "INF");
}

ZTEST_SUITE(slice, NULL, NULL, NULL, NULL, NULL);
```

## src/strutil_test.c
```c
// SPDX-FileCopyrightText: 2025 夕月霞
// SPDX-License-Identifier: AGPL-3.0-or-later
#include "strutil.h"

#include <zephyr/ztest.h>

ZTEST(strutil, test_sl_is_empty) {
  zassert_true(sl_is_empty(sl_empty()));
  zassert_true(sl_is_empty(sl_from_str("")));
  zassert_false(sl_is_empty(sl_from_str("abc")));
}

ZTEST(strutil, test_sl_eq) {
  zassert_true(sl_eq(sl_empty(), sl_empty()));
  zassert_true(sl_eq(sl_from_str("abc"), sl_from_str("abc")));

  {
    uint8_t buf1[1];
    uint8_t buf2[1];
    buf1[0] = 'a';
    buf2[0] = 'a';
    slice_t s1 = {.size = 1, .ptr = buf1};
    slice_t s2 = {.size = 1, .ptr = buf2};
    zassert_true(sl_eq(s1, s2), "different pointer, same content");
  }

  {
    uint8_t buf1[2];
    uint8_t buf2[2];
    slice_t s1 = {.size = 2, .ptr = buf1};
    slice_t s2 = {.size = 2, .ptr = buf2};
    buf1[0] = 0;
    buf1[1] = 'a';
    buf2[0] = 0;
    buf2[1] = 'a';
    zassert_true(sl_eq(s1, s2), "content after null matters");

    buf1[0] = 0;
    buf1[1] = 'a';
    buf2[0] = 0;
    buf2[1] = 'b';
    zassert_false(sl_eq(s1, s2), "content after null matters");
  }
}

ZTEST(strutil, test_sl_eq_str) {
  zassert_true(sl_eq_str(sl_empty(), ""));
  zassert_true(sl_eq_str(sl_from_str("abc"), "abc"));

  zassert_false(sl_eq_str(sl_empty(), "a"));
  zassert_false(sl_eq_str(sl_from_str("a"), ""));
}

ZTEST(strutil, test_sl_sub) {
  slice_t s = sl_from_str("abc");

  // basic use cases
  zassert_true(sl_eq_str(sl_sub(s, 0, 3), "abc"));
  zassert_true(sl_eq_str(sl_sub(s, 0, 2), "ab"));
  zassert_true(sl_eq_str(sl_sub(s, 1, 3), "bc"));
  zassert_true(sl_eq_str(sl_sub(s, 0, 0), ""));

  // edge cases
  zassert_true(sl_eq_str(sl_sub(s, 0, 10), "abc"));
  zassert_true(sl_eq_str(sl_sub(s, -10, 3), "abc"));
  zassert_true(sl_eq_str(sl_sub(s, 3, 0), ""));
}

ZTEST(strutil, test_sl_split_at) {
  slice_t ret, rem;

  ret = sl_split_at(sl_from_str("a.b.c"), '.', &rem);
  zassert_true(sl_eq_str(ret, "a"));
  zassert_true(sl_eq_str(rem, "b.c"));

  ret = sl_split_at(sl_from_str("a."), '.', &rem);
  zassert_true(sl_eq_str(ret, "a"));
  zassert_true(sl_is_empty(rem));

  ret = sl_split_at(sl_from_str("a"), '.', &rem);
  zassert_true(sl_eq_str(ret, "a"));
  zassert_true(sl_is_empty(rem));

  ret = sl_split_at(sl_from_str(".a"), '.', &rem);
  zassert_true(sl_is_empty(ret));
  zassert_true(sl_eq_str(rem, "a"));

  ret = sl_split_at(sl_from_str("."), '.', &rem);
  zassert_true(sl_is_empty(ret));
  zassert_true(sl_is_empty(rem));

  ret = sl_split_at(sl_from_str(""), '.', &rem);
  zassert_true(sl_is_empty(ret));
  zassert_true(sl_is_empty(rem));
}

ZTEST(strutil, test_sl_split_at_null_rem) {
  slice_t ret = sl_split_at(sl_from_str("a.b.c"), '.', NULL);
  zassert_true(sl_eq_str(ret, "a"));
}

ZTEST(strutil, test_sl_split_by_spaces) {
  slice_t ret, rem;

  ret = sl_split_by_spaces(sl_from_str("a  b  c"), &rem);
  zassert_true(sl_eq_str(ret, "a"));
  zassert_true(sl_eq_str(rem, "b  c"));

  ret = sl_split_by_spaces(sl_from_str("a "), &rem);
  zassert_true(sl_eq_str(ret, "a"));
  zassert_true(sl_is_empty(rem));

  ret = sl_split_by_spaces(sl_from_str("a"), &rem);
  zassert_true(sl_eq_str(ret, "a"));
  zassert_true(sl_is_empty(rem));

  ret = sl_split_by_spaces(sl_from_str(" a"), &rem);
  zassert_true(sl_is_empty(ret));
  zassert_true(sl_eq_str(rem, "a"));

  ret = sl_split_by_spaces(sl_from_str("  "), &rem);
  zassert_true(sl_is_empty(ret));
  zassert_true(sl_is_empty(rem));

  ret = sl_split_by_spaces(sl_from_str(""), &rem);
  zassert_true(sl_is_empty(ret));
  zassert_true(sl_is_empty(rem));
}

ZTEST(strutil, test_sl_split_by_spaces_null_rem) {
  slice_t ret;

  ret = sl_split_by_spaces(sl_from_str("a  b  c"), NULL);
  zassert_true(sl_eq_str(ret, "a"));

  ret = sl_split_by_spaces(sl_from_str("a "), NULL);
  zassert_true(sl_eq_str(ret, "a"));

  ret = sl_split_by_spaces(sl_from_str("a"), NULL);
  zassert_true(sl_eq_str(ret, "a"));

  ret = sl_split_by_spaces(sl_from_str(" a"), NULL);
  zassert_true(sl_is_empty(ret));

  ret = sl_split_by_spaces(sl_from_str("  "), NULL);
  zassert_true(sl_is_empty(ret));

  ret = sl_split_by_spaces(sl_from_str(""), NULL);
  zassert_true(sl_is_empty(ret));
}

ZTEST(strutil, test_sl_parse_int_valid) {
  int value;
  zassert_true(sl_parse_int(sl_from_str("123"), &value));
  zassert_equal(value, 123);

  zassert_true(sl_parse_int(sl_from_str("-456"), &value));
  zassert_equal(value, -456);

  zassert_true(sl_parse_int(sl_from_str("0"), &value));
  zassert_equal(value, 0);

  zassert_true(sl_parse_int(sl_from_str("2147483647"), &value), "max int32");
  zassert_equal(value, 2147483647);

  zassert_true(sl_parse_int(sl_from_str("-2147483648"), &value), "min int32");
  zassert_equal(value, -2147483648);
}

ZTEST(strutil, test_sl_parse_int_invalid) {
  int value;
  zassert_false(sl_parse_int(sl_from_str(" 123"), &value), "pre-space");
  zassert_false(sl_parse_int(sl_from_str("123 "), &value), "post-space");
  zassert_false(sl_parse_int(sl_from_str("1.2"), &value), "float");
  zassert_false(sl_parse_int(sl_from_str("0x123"), &value), "hex");
  zassert_false(sl_parse_int(sl_from_str("1000000000000000"), &value),
                "bigint");
}

ZTEST(strutil, test_sl_parse_float_valid) {
  float value;
  zassert_true(sl_parse_float(sl_from_str("123.45"), &value));
  zassert_equal(value, 123.45f);

  zassert_true(sl_parse_float(sl_from_str("1.2345e2"), &value));
  zassert_equal(value, 123.45f);
}

ZTEST(strutil, test_sl_parse_float_invalid) {
  float value;
  zassert_false(sl_parse_float(sl_from_str(" 123.45"), &value), "pre-space");
  zassert_false(sl_parse_float(sl_from_str("123.45 "), &value), "post-space");
  zassert_false(sl_parse_float(sl_from_str("12.3.4"), &value), "multi-dot");
  zassert_false(sl_parse_float(sl_from_str("1e1000"), &value), "big float");
  zassert_false(sl_parse_float(sl_from_str("NAN"), &value), "NAN");
  zassert_false(sl_parse_float(sl_from_str("INF"), &value), "INF");
}

ZTEST_SUITE(strutil, NULL, NULL, NULL, NULL, NULL);
```
