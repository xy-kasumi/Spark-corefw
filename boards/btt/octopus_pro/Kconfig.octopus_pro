## boards/btt/octopus_pro/Kconfig.octopus_pro
```kconfig
# SPDX-License-Identifier: CC0-1.0
config BOARD_OCTOPUS_PRO
	select SOC_STM32H723XX
```

## boards/btt/octopus_pro/board.yml
```yaml
# SPDX-License-Identifier: CC0-1.0
board:
  name: octopus_pro
  vendor: btt
  socs:
    - name: stm32h723xx
```

## boards/btt/octopus_pro/octopus_pro_defconfig
```kconfig
# SPDX-License-Identifier: CC0-1.0
# Clock configuration
CONFIG_SYS_CLOCK_HW_CYCLES_PER_SEC=550000000
CONFIG_SYS_CLOCK_TICKS_PER_SEC=50000
CONFIG_COUNTER_TIMER_STM32=y
CONFIG_RTC_STM32=n  # No RTC connected

# Basic I/O
CONFIG_SERIAL=y
CONFIG_GPIO=y
CONFIG_I2C=y
```

## boards/btt_octopus_pro/Kconfig.octopus_pro
```kconfig
# SPDX-FileCopyrightText: 2025 夕月霞
# SPDX-License-Identifier: AGPL-3.0-or-later

config BOARD_OCTOPUS_PRO
	select SOC_STM32H723XX
```

## boards/btt_octopus_pro/octopus_pro_defconfig
```kconfig
# SPDX-FileCopyrightText: 2025 夕月霞
# SPDX-License-Identifier: AGPL-3.0-or-later

# Clock configuration
CONFIG_SYS_CLOCK_HW_CYCLES_PER_SEC=550000000
CONFIG_SYS_CLOCK_TICKS_PER_SEC=50000
CONFIG_COUNTER_TIMER_STM32=y
CONFIG_RTC_STM32=n  # No RTC connected

# Debug and SWD configuration
CONFIG_DEBUG=y
CONFIG_DEBUG_INFO=y
CONFIG_DEBUG_OPTIMIZATIONS=y

# Enable UART console on all configurations for convenience. This is usually
# done at board level upstream so that all samples output printed messages to
# the configured #zephyr,console. In production boards, this may be enabled at
# application level or in a debug configuration overlay.
CONFIG_SERIAL=y
CONFIG_CONSOLE=y
CONFIG_UART_CONSOLE=y
```

## drivers/motor/Kconfig
```kconfig
# SPDX-License-Identifier: CC0-1.0

config TMC2209_MOTOR_DRIVER
	bool "TMC2209 Stepper Motor Driver"
	default y
	help
	  Enable TMC2209 stepper motor driver with UART communication
	  and StallGuard load detection capabilities.
```

## dts/bindings/motor/adi,tmc2209-uart.yaml
```yaml
# SPDX-License-Identifier: CC0-1.0
# TMC2209 stepper motor driver device tree binding (UART interface)

description: Trinamic TMC2209 Stepper Motor Driver with UART interface

compatible: "adi,tmc2209-uart"

properties:
  step-gpios:
    type: phandle-array
    required: true
    description: GPIO pin for step signal

  dir-gpios:
    type: phandle-array
    required: true
    description: GPIO pin for direction signal

  enable-gpios:
    type: phandle-array
    required: true
    description: GPIO pin for motor enable (active low)

  uart-gpios:
    type: phandle-array
    required: true
    description: GPIO pin for single-wire UART communication

  diag-gpios:
    type: phandle-array
    required: true
    description: GPIO pin for diagnostic/stall detection

  uart-timer:
    type: phandle
    required: true
    description: Timer device for UART bit-banging (shared across multiple TMC devices)
```

## west.yml
```yaml
# SPDX-FileCopyrightText: 2025 夕月霞
# SPDX-License-Identifier: AGPL-3.0-or-later

manifest:
  remotes:
    - name: zephyrproject-rtos
      url-base: https://github.com/zephyrproject-rtos

  projects:
    - name: zephyr
      remote: zephyrproject-rtos
      revision: main
      import:
        name-allowlist:
          - cmsis_6
          - hal_stm32
```
